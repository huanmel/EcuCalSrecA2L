/******************************************************************************
* ASAP2 file: A2L_MAP_FILE.a2l
* Code generation for model "A2L_MAP_FILE".
* Model version : 28.916
* Simulink Coder version : 24.1 (R2024a) 19-Nov-2023
* C source code generated on : Wed Jul 30 20:36:19 2025
* Target selection: MPC5644A.tlc
* Embedded hardware selection: Freescale->MPC55xx
* Code generation objectives: Unspecified
* Validation result: Not run
* (add additional file header information here)
******************************************************************************/ ASAP2_VERSION 1 31
/* Version 1.31 */
/begin PROJECT ProjectName "Project Comment Goes Here"
/begin HEADER "Header Comments go here" /end HEADER
/begin MODULE ModuleName "Module Comment Goes Here"
/* EcoCoder v2.9.15 R2 Target:ES1274A verCalTool:0.0*/
/* XCP-En:0 XCPCalTool:EcoCAL INCA CANape XCP-CAN:CAN_CTRL_C XCP-CAN-Baud:250000bps*/
/* CCP-En:1 CCP-TYPE:Configurable CCPCalTool:EcoCAL INCA CCP-CAN:CAN_CTRL_A CCP-CAN-Baud:250000bps*/
/*PGCANAEn:NoUse PGCANAStation:NoUse PGCANABaud:250kbps PGCANACRO:NoUse PGCANADTO:NoUse*/
/*PGCANBEn:NoUse PGCANBStation:NoUse PGCANBBaud:250kbps PGCANBCRO:NoUse PGCANBDTO:NoUse*/
/*PGCANCEn:NoUse PGCANCStation:NoUse PGCANCBaud:250kbps PGCANCCRO:NoUse PGCANCDTO:NoUse*/
/*PGCANDEn:NoUse PGCANDStation:NoUse PGCANDBaud:NoUsekbps PGCANDCRO:NoUse PGCANDDTO:NoUse*/
/*ECO_XCP_Note_Start
/begin IF_DATA XCP
/begin PROTOCOL_LAYER
0x0100
0x07D0
0x2710
0x3E8
0x2710
0x3E8
0x19
0x19
0x08
0x08
BYTE_ORDER_MSB_FIRST
ADDRESS_GRANULARITY_BYTE
OPTIONAL_CMD ALLOC_ODT_ENTRY
OPTIONAL_CMD ALLOC_ODT
OPTIONAL_CMD ALLOC_DAQ
OPTIONAL_CMD FREE_DAQ
OPTIONAL_CMD GET_DAQ_EVENT_INFO
OPTIONAL_CMD GET_DAQ_RESOLUTION_INFO
OPTIONAL_CMD GET_DAQ_PROCESSOR_INFO
OPTIONAL_CMD START_STOP_SYNCH
OPTIONAL_CMD START_STOP_DAQ_LIST
OPTIONAL_CMD GET_DAQ_LIST_MODE
OPTIONAL_CMD SET_DAQ_LIST_MODE
OPTIONAL_CMD WRITE_DAQ
OPTIONAL_CMD SET_DAQ_PTR
OPTIONAL_CMD CLEAR_DAQ_LIST
OPTIONAL_CMD DOWNLOAD
OPTIONAL_CMD SHORT_UPLOAD
OPTIONAL_CMD UPLOAD
OPTIONAL_CMD SET_MTA
OPTIONAL_CMD UNLOCK
OPTIONAL_CMD GET_SEED
OPTIONAL_CMD GET_ID
OPTIONAL_CMD GET_COMM_MODE_INFO
OPTIONAL_CMD BUILD_CHECKSUM
SEED_AND_KEY_EXTERNAL_FUNCTION ""
/end PROTOCOL_LAYER
/begin DAQ
DYNAMIC
0x00
0x05
0x00
OPTIMISATION_TYPE_DEFAULT
ADDRESS_EXTENSION_FREE
IDENTIFICATION_FIELD_TYPE_ABSOLUTE
GRANULARITY_ODT_ENTRY_SIZE_DAQ_BYTE
0x07
OVERLOAD_INDICATION_PID
/begin STIM
GRANULARITY_ODT_ENTRY_SIZE_STIM_BYTE
0x07
/end STIM
/begin EVENT
"5ms"
"5ms"
0x00
DAQ
0x01
0x05
0x06
0x00
/end EVENT
/begin EVENT
"20ms"
"20ms"
0x01
DAQ
0x01
0x02
0x07
0x00
/end EVENT
/begin EVENT
"50ms"
"50ms"
0x02
DAQ
0x01
0x05
0x07
0x00
/end EVENT
/begin EVENT
"100ms"
"100ms"
0x03
DAQ
0x01
0x01
0x08
0x00
/end EVENT
/begin EVENT
"200ms"
"200m"
0x04
DAQ
0x01
0x02
0x08
0x00
/end EVENT
/end DAQ
/begin PAG
0x00
/end PAG
/begin PGM
PGM_MODE_ABSOLUTE
0x00
0x00
/end PGM
/begin XCP_ON_CAN
0x0100
CAN_ID_MASTER 0x200
CAN_ID_SLAVE 0x201
BAUDRATE 250000
SAMPLE_POINT 0x4B
SAMPLE_RATE SINGLE
BTL_CYCLES 0x08
SJW 0x02
SYNC_EDGE SINGLE
/end XCP_ON_CAN
/end IF_DATA
/begin IF_DATA CANAPE_ADDRESS_UPDATE
/end IF_DATA
/begin MOD_PAR "_default_ModParComment"
/begin MEMORY_SEGMENT _ROMCAL
"calibration_rom"
DATA
FLASH
INTERN
0x00FD0000
0x8000
-1 -1 -1 -1 -1
/begin IF_DATA XCP
/begin SEGMENT
0x00
0x01
0x00
0x00
0x00
/begin CHECKSUM
XCP_CRC_16_CITT
MAX_BLOCK_SIZE 0xFFFF
EXTERNAL_FUNCTION "String.Empty"
/end CHECKSUM
/begin PAGE
0x00
ECU_ACCESS_DONT_CARE
XCP_READ_ACCESS_DONT_CARE
XCP_WRITE_ACCESS_DONT_CARE
INIT_SEGMENT 0x00
/end PAGE
/begin ADDRESS_MAPPING
0x00FD0000
0x40000000
0x8000
/end ADDRESS_MAPPING
/end SEGMENT
/end IF_DATA
/end MEMORY_SEGMENT
/begin MEMORY_SEGMENT _CODE
"ecu_code"
CODE
FLASH
INTERN
0x01000200
0x1FFA00
-1 -1 -1 -1 -1
/end MEMORY_SEGMENT
/end MOD_PAR
ECO_XCP_Note_End*/
/*ECO_CCP_Note_Start*/
/begin MOD_PAR "_default_ModParComment" ADDR_EPK 0x01000100 EPK "ES1274A EcoCoder v2.9.15 R2 2025-07-30 20:36:20"
 /begin MEMORY_SEGMENT _RAMCAL "calibration_ram" DATA RAM INTERN 0x40000000 0x8000 -1 -1 -1 -1 -1 /end MEMORY_SEGMENT
 /begin MEMORY_SEGMENT _ROMCAL "calibration_rom" DATA FLASH INTERN 0x00FD0000 0x8000 -1 -1 -1 -1 -1
  /begin IF_DATA ASAP1B_CCP ADDRESS_MAPPING 0x00FD0000 0x40000000 0x8000 /*EcoCoderCANapeStart
ADDR_MAPPING 0x00FD0000 0x40000000 0x8000
EcoCoderCANapeEnd*/ /end IF_DATA
 /end MEMORY_SEGMENT
 /begin MEMORY_SEGMENT _epk_data "epk_data" DATA FLASH INTERN 0x01000100 0xFF -1 -1 -1 -1 -1
  /begin IF_DATA ASAP1B_CCP ADDRESS_MAPPING 0x01000100 0x01000100 0xFF /*EcoCoderCANapeStart
ADDR_MAPPING 0x01000100 0x01000100 0xFF
EcoCoderCANapeEnd*/ /end IF_DATA
 /end MEMORY_SEGMENT
 /begin MEMORY_SEGMENT _CODE "ecu_code" CODE FLASH INTERN 0x01000200 0x1FFA00 -1 -1 -1 -1 -1 /end MEMORY_SEGMENT
/end MOD_PAR
/begin IF_DATA ASAP1B_CCP
 /begin SOURCE "10ms" 3 10 DISPLAY_IDENTIFIER DAQ0
  /begin QP_BLOB 0 LENGTH 0xA CAN_ID_FIXED 0x210 RASTER 0 REDUCTION_ALLOWED FIRST_PID 0x0 /end QP_BLOB
 /end SOURCE
 /begin SOURCE "20ms" 3 20 DISPLAY_IDENTIFIER DAQ2
  /begin QP_BLOB 1 LENGTH 0x20 CAN_ID_FIXED 0x211 RASTER 1 REDUCTION_ALLOWED FIRST_PID 0x0 /end QP_BLOB
 /end SOURCE
 /begin SOURCE "100ms" 3 100 DISPLAY_IDENTIFIER DAQ3
  /begin QP_BLOB 2 LENGTH 0x30 CAN_ID_FIXED 0x212 RASTER 2 REDUCTION_ALLOWED FIRST_PID 0x0 /end QP_BLOB
 /end SOURCE
 /begin SOURCE "200ms" 3 200 DISPLAY_IDENTIFIER DAQ3
  /begin QP_BLOB 3 LENGTH 0x50 CAN_ID_FIXED 0x213 RASTER 3 REDUCTION_ALLOWED FIRST_PID 0x0 /end QP_BLOB
 /end SOURCE
 /begin RASTER "10ms" "10ms" 0 3 10 /end RASTER
 /begin RASTER "20ms" "20ms" 1 3 20 /end RASTER
 /begin RASTER "100ms" "100ms" 2 3 100 /end RASTER
 /begin RASTER "200ms" "200ms" 3 3 200 /end RASTER
 /begin SEED_KEY "" "" "" /end SEED_KEY
 /begin CHECKSUM "CRC16.dll" /end CHECKSUM
 /begin TP_BLOB 0x0201 0x0204 0x200 0x201 0x112 1 BAUDRATE 250000 SAMPLE_POINT 70 SAMPLE_RATE 1 BTL_CYCLES 10 SJW 1 SYNC_EDGE SINGLE DAQ_MODE 0 CONSISTENCY 1 ADDRESS_EXTENSION 0 RESUME_SUPPORTED STORE_SUPPORTED
  /begin CHECKSUM_PARAM 0x9001 /*EcoCoderCANapeStart
0x0C
EcoCoderCANapeEnd*/ 0xffffffff CHECKSUM_CALCULATION ACTIVE_PAGE /end CHECKSUM_PARAM
  /begin DEFINED_PAGES 0x00 "RAM_PAGE" 0x00 0x40000000 0x8000 RAM RAM_INIT_BY_ECU /end DEFINED_PAGES
  OPTIONAL_CMD 0X5 OPTIONAL_CMD 0X8 OPTIONAL_CMD 0X9 OPTIONAL_CMD 0XC OPTIONAL_CMD 0XD OPTIONAL_CMD 0XE OPTIONAL_CMD 0XF OPTIONAL_CMD 0X10 OPTIONAL_CMD 0X11 OPTIONAL_CMD 0X12 OPTIONAL_CMD 0X13 OPTIONAL_CMD 0X18 OPTIONAL_CMD 0X19 OPTIONAL_CMD 0X20 OPTIONAL_CMD 0X21 OPTIONAL_CMD 0X22 OPTIONAL_CMD 0X23 /end TP_BLOB
/end IF_DATA
/*ECO_CCP_Note_End*/
/begin MOD_COMMON "" /* Comment */ ALIGNMENT_BYTE 1 ALIGNMENT_WORD 1 ALIGNMENT_LONG 1 ALIGNMENT_FLOAT32_IEEE 1 ALIGNMENT_FLOAT64_IEEE 1 BYTE_ORDER MSB_FIRST DEPOSIT ABSOLUTE /end MOD_COMMON
/begin RECORD_LAYOUT Scalar_BOOLEAN FNC_VALUES 1 UBYTE COLUMN_DIR DIRECT /end RECORD_LAYOUT
/begin RECORD_LAYOUT Scalar_UBYTE FNC_VALUES 1 UBYTE COLUMN_DIR DIRECT /end RECORD_LAYOUT
/begin RECORD_LAYOUT Scalar_BYTE FNC_VALUES 1 SBYTE COLUMN_DIR DIRECT /end RECORD_LAYOUT
/begin RECORD_LAYOUT Scalar_UWORD FNC_VALUES 1 UWORD COLUMN_DIR DIRECT /end RECORD_LAYOUT
/begin RECORD_LAYOUT Scalar_SWORD FNC_VALUES 1 SWORD COLUMN_DIR DIRECT /end RECORD_LAYOUT
/begin RECORD_LAYOUT Scalar_ULONG FNC_VALUES 1 ULONG COLUMN_DIR DIRECT /end RECORD_LAYOUT
/begin RECORD_LAYOUT Scalar_LONG FNC_VALUES 1 SLONG COLUMN_DIR DIRECT /end RECORD_LAYOUT
/begin RECORD_LAYOUT Scalar_FLOAT32_IEEE FNC_VALUES 1 FLOAT32_IEEE COLUMN_DIR DIRECT /end RECORD_LAYOUT
/begin RECORD_LAYOUT Scalar_FLOAT64_IEEE FNC_VALUES 1 FLOAT64_IEEE COLUMN_DIR DIRECT /end RECORD_LAYOUT
/begin RECORD_LAYOUT Lookup1D_BOOLEAN FNC_VALUES 1 UBYTE COLUMN_DIR DIRECT /end RECORD_LAYOUT
/begin RECORD_LAYOUT Lookup1D_X_BOOLEAN AXIS_PTS_X 1 UBYTE INDEX_INCR DIRECT /end RECORD_LAYOUT
/begin RECORD_LAYOUT Lookup1D_BYTE FNC_VALUES 1 SBYTE COLUMN_DIR DIRECT /end RECORD_LAYOUT
/begin RECORD_LAYOUT Lookup1D_X_BYTE AXIS_PTS_X 1 SBYTE INDEX_INCR DIRECT /end RECORD_LAYOUT
/begin RECORD_LAYOUT Lookup1D_UBYTE FNC_VALUES 1 UBYTE COLUMN_DIR DIRECT /end RECORD_LAYOUT
/begin RECORD_LAYOUT Lookup1D_X_UBYTE AXIS_PTS_X 1 UBYTE INDEX_INCR DIRECT /end RECORD_LAYOUT
/begin RECORD_LAYOUT Lookup1D_UWORD FNC_VALUES 1 UWORD COLUMN_DIR DIRECT /end RECORD_LAYOUT
/begin RECORD_LAYOUT Lookup1D_X_UWORD AXIS_PTS_X 1 UWORD INDEX_INCR DIRECT /end RECORD_LAYOUT
/begin RECORD_LAYOUT Lookup1D_WORD FNC_VALUES 1 SWORD COLUMN_DIR DIRECT /end RECORD_LAYOUT
/begin RECORD_LAYOUT Lookup1D_X_WORD AXIS_PTS_X 1 SWORD INDEX_INCR DIRECT /end RECORD_LAYOUT
/begin RECORD_LAYOUT Lookup1D_ULONG FNC_VALUES 1 ULONG COLUMN_DIR DIRECT /end RECORD_LAYOUT
/begin RECORD_LAYOUT Lookup1D_X_ULONG AXIS_PTS_X 1 ULONG INDEX_INCR DIRECT /end RECORD_LAYOUT
/begin RECORD_LAYOUT Lookup1D_SLONG FNC_VALUES 1 SLONG COLUMN_DIR DIRECT /end RECORD_LAYOUT
/begin RECORD_LAYOUT Lookup1D_X_LONG AXIS_PTS_X 1 SLONG INDEX_INCR DIRECT /end RECORD_LAYOUT
/begin RECORD_LAYOUT Lookup1D_FLOAT32_IEEE FNC_VALUES 1 FLOAT32_IEEE COLUMN_DIR DIRECT /end RECORD_LAYOUT
/begin RECORD_LAYOUT Lookup1D_X_FLOAT32_IEEE AXIS_PTS_X 1 FLOAT32_IEEE INDEX_INCR DIRECT /end RECORD_LAYOUT
/begin RECORD_LAYOUT Lookup1D_FLOAT64_IEEE FNC_VALUES 1 FLOAT64_IEEE COLUMN_DIR DIRECT /end RECORD_LAYOUT
/begin RECORD_LAYOUT Lookup1D_X_FLOAT64_IEEE AXIS_PTS_X 1 FLOAT64_IEEE INDEX_INCR DIRECT /end RECORD_LAYOUT
/begin RECORD_LAYOUT Lookup2D_BOOLEAN FNC_VALUES 1 UBYTE COLUMN_DIR DIRECT /end RECORD_LAYOUT
/begin RECORD_LAYOUT Lookup2D_X_BOOLEAN AXIS_PTS_X 1 UBYTE INDEX_INCR DIRECT /end RECORD_LAYOUT
/begin RECORD_LAYOUT Lookup2D_UBYTE FNC_VALUES 1 UBYTE COLUMN_DIR DIRECT /end RECORD_LAYOUT
/begin RECORD_LAYOUT Lookup2D_X_UBYTE AXIS_PTS_X 1 UBYTE INDEX_INCR DIRECT /end RECORD_LAYOUT
/begin RECORD_LAYOUT Lookup2D_BYTE FNC_VALUES 1 SBYTE COLUMN_DIR DIRECT /end RECORD_LAYOUT
/begin RECORD_LAYOUT Lookup2D_X_BYTE AXIS_PTS_X 1 SBYTE INDEX_INCR DIRECT /end RECORD_LAYOUT
/begin RECORD_LAYOUT Lookup2D_UWORD FNC_VALUES 1 UWORD COLUMN_DIR DIRECT /end RECORD_LAYOUT
/begin RECORD_LAYOUT Lookup2D_X_UWORD AXIS_PTS_X 1 UWORD INDEX_INCR DIRECT /end RECORD_LAYOUT
/begin RECORD_LAYOUT Lookup2D_WORD FNC_VALUES 1 SWORD COLUMN_DIR DIRECT /end RECORD_LAYOUT
/begin RECORD_LAYOUT Lookup2D_X_WORD AXIS_PTS_X 1 SWORD INDEX_INCR DIRECT /end RECORD_LAYOUT
/begin RECORD_LAYOUT Lookup2D_ULONG FNC_VALUES 1 ULONG COLUMN_DIR DIRECT /end RECORD_LAYOUT
/begin RECORD_LAYOUT Lookup2D_X_ULONG AXIS_PTS_X 1 ULONG INDEX_INCR DIRECT /end RECORD_LAYOUT
/begin RECORD_LAYOUT Lookup2D_LONG FNC_VALUES 1 SLONG COLUMN_DIR DIRECT /end RECORD_LAYOUT
/begin RECORD_LAYOUT Lookup2D_X_LONG AXIS_PTS_X 1 SLONG INDEX_INCR DIRECT /end RECORD_LAYOUT
/begin RECORD_LAYOUT Lookup2D_FLOAT32_IEEE FNC_VALUES 1 FLOAT32_IEEE COLUMN_DIR DIRECT /end RECORD_LAYOUT
/begin RECORD_LAYOUT Lookup2D_X_FLOAT32_IEEE AXIS_PTS_X 1 FLOAT32_IEEE INDEX_INCR DIRECT /end RECORD_LAYOUT
/begin RECORD_LAYOUT Lookup2D_FLOAT64_IEEE FNC_VALUES 1 FLOAT64_IEEE COLUMN_DIR DIRECT /end RECORD_LAYOUT
/begin RECORD_LAYOUT Lookup2D_X_FLOAT64_IEEE AXIS_PTS_X 1 FLOAT64_IEEE INDEX_INCR DIRECT /end RECORD_LAYOUT
/begin CHARACTERISTIC PwrMCU_tDbncKeyOff_val "" VALUE 0xfd0020 /* @ECU_Address@PwrMCU_tDbncKeyOff_val@ */ Scalar_FLOAT32_IEEE 0 EKL_DP187_v0_CM_single_s -3.4E+38 3.4E+38 /end CHARACTERISTIC
/begin CHARACTERISTIC PwrMCU_tDbncKeyOn_val "" VALUE 0xfd0024 /* @ECU_Address@PwrMCU_tDbncKeyOn_val@ */ Scalar_FLOAT32_IEEE 0 EKL_DP187_v0_CM_single_s -3.4E+38 3.4E+38 /end CHARACTERISTIC
/begin CHARACTERISTIC PwrMCU_tResetDbncKeyOffFall_val "" VALUE 0xfd0028 /* @ECU_Address@PwrMCU_tResetDbncKeyOffFall_val@ */ Scalar_FLOAT32_IEEE 0 EKL_DP187_v0_CM_single_s -3.4E+38 3.4E+38 /end CHARACTERISTIC
/begin CHARACTERISTIC PwrMCU_tResetDbncKeyOffRise_val "" VALUE 0xfd002c /* @ECU_Address@PwrMCU_tResetDbncKeyOffRise_val@ */ Scalar_FLOAT32_IEEE 0 EKL_DP187_v0_CM_single_s -3.4E+38 3.4E+38 /end CHARACTERISTIC
/begin CHARACTERISTIC PwrMCU_tShutDownDelay_val "" VALUE 0xfd0030 /* @ECU_Address@PwrMCU_tShutDownDelay_val@ */ Scalar_FLOAT32_IEEE 0 EKL_DP187_v0_CM_single_s -3.4E+38 3.4E+38 /end CHARACTERISTIC
/begin CHARACTERISTIC PwrMCU_tWaitKeyOn_val "" VALUE 0xfd0034 /* @ECU_Address@PwrMCU_tWaitKeyOn_val@ */ Scalar_FLOAT32_IEEE 0 EKL_DP187_v0_CM_single_s -3.4E+38 3.4E+38 /end CHARACTERISTIC
/begin CHARACTERISTIC SnsrPHi_FilTiCon "" VALUE 0xfd0038 /* @ECU_Address@SnsrPHi_FilTiCon@ */ Scalar_FLOAT32_IEEE 0 EKL_DP187_v0_CM_single_sec 0.0 100.0 /end CHARACTERISTIC
/begin CHARACTERISTIC SnsrPHi_PMapY "Ydat" VAL_BLK 0xfd003c /* @ECU_Address@SnsrPHi_PMapY@ */ Scalar_FLOAT32_IEEE 0 EKL_DP187_v0_CM_single_kPa -3.4E+38 3.4E+38 NUMBER 2 /end CHARACTERISTIC
/begin CHARACTERISTIC SnsrPHi_PMinMax "" VAL_BLK 0xfd0044 /* @ECU_Address@SnsrPHi_PMinMax@ */ Scalar_FLOAT32_IEEE 0 EKL_DP187_v0_CM_single_kPa 0.0 10000.0 NUMBER 2 /end CHARACTERISTIC
/begin CHARACTERISTIC SnsrPHi_POfs "Output pressure calibration offset" VALUE 0xfd004c /* @ECU_Address@SnsrPHi_POfs@ */ Scalar_FLOAT32_IEEE 0 EKL_DP187_v0_CM_single_kPa -3.4E+38 3.4E+38 /end CHARACTERISTIC
/begin CHARACTERISTIC SnsrPHi_VoltMapX "Xdat" VAL_BLK 0xfd0050 /* @ECU_Address@SnsrPHi_VoltMapX@ */ Scalar_FLOAT32_IEEE 0 EKL_DP187_v0_CM_single 0.0 12.0 NUMBER 2 /end CHARACTERISTIC
/begin CHARACTERISTIC SnsrPHi_VoltMinMax "" VAL_BLK 0xfd0058 /* @ECU_Address@SnsrPHi_VoltMinMax@ */ Scalar_FLOAT32_IEEE 0 EKL_DP187_v0_CM_single_V 0.0 5.0 NUMBER 2 /end CHARACTERISTIC
/begin CHARACTERISTIC SnsrPLo_FilTiCon "" VALUE 0xfd0060 /* @ECU_Address@SnsrPLo_FilTiCon@ */ Scalar_FLOAT32_IEEE 0 EKL_DP187_v0_CM_single_sec 0.0 100.0 /end CHARACTERISTIC
/begin CHARACTERISTIC SnsrPLo_PMapY "Ydat" VAL_BLK 0xfd0064 /* @ECU_Address@SnsrPLo_PMapY@ */ Scalar_FLOAT32_IEEE 0 PROJ_v0_CM_single_kPa -3.4E+38 3.4E+38 NUMBER 2 /end CHARACTERISTIC
/begin CHARACTERISTIC SnsrPLo_PMinMax "" VAL_BLK 0xfd006c /* @ECU_Address@SnsrPLo_PMinMax@ */ Scalar_FLOAT32_IEEE 0 PROJ_v0_CM_single_kPa 0.0 10000.0 NUMBER 2 /end CHARACTERISTIC
/begin CHARACTERISTIC SnsrPLo_POfs "Output pressure calibration offset" VALUE 0xfd0074 /* @ECU_Address@SnsrPLo_POfs@ */ Scalar_FLOAT32_IEEE 0 PROJ_v0_CM_single_kPa -3.4E+38 3.4E+38 /end CHARACTERISTIC
/begin CHARACTERISTIC SnsrPLo_VoltMapX "Xdat" VAL_BLK 0xfd0078 /* @ECU_Address@SnsrPLo_VoltMapX@ */ Scalar_FLOAT32_IEEE 0 PROJ_v0_CM_single 0.0 12.0 NUMBER 2 /end CHARACTERISTIC
/begin CHARACTERISTIC SnsrPLo_VoltMinMax "" VAL_BLK 0xfd0080 /* @ECU_Address@SnsrPLo_VoltMinMax@ */ Scalar_FLOAT32_IEEE 0 PROJ_v0_CM_single_V 0.0 5.0 NUMBER 2 /end CHARACTERISTIC
/begin CHARACTERISTIC SnsrTBattCoolt_FilTiCon "" VALUE 0xfd0088 /* @ECU_Address@SnsrTBattCoolt_FilTiCon@ */ Scalar_FLOAT32_IEEE 0 PROJ_v0_CM_single_sec 0.0 100.0 /end CHARACTERISTIC
/begin CHARACTERISTIC SnsrTBattCoolt_RMapX "Xdat" VAL_BLK 0xfd008c /* @ECU_Address@SnsrTBattCoolt_RMapX@ */ Scalar_FLOAT32_IEEE 0 PROJ_v0_CM_single_Ohm 0.0 3.4E+38 NUMBER 10 /end CHARACTERISTIC
/begin CHARACTERISTIC SnsrTBattCoolt_Rext "external resistance" VALUE 0xfd00b4 /* @ECU_Address@SnsrTBattCoolt_Rext@ */ Scalar_FLOAT32_IEEE 0 PROJ_v0_CM_single_kOhm 1.0 3.4E+38 /end CHARACTERISTIC
/begin CHARACTERISTIC SnsrTBattCoolt_Rint "internal resistance" VALUE 0xfd00b8 /* @ECU_Address@SnsrTBattCoolt_Rint@ */ Scalar_FLOAT32_IEEE 0 PROJ_v0_CM_single_kOhm 1.0 3.4E+38 /end CHARACTERISTIC
/begin CHARACTERISTIC SnsrTBattCoolt_TDegMapY "Ydat" VAL_BLK 0xfd00c0 /* @ECU_Address@SnsrTBattCoolt_TDegMapY@ */ Scalar_FLOAT32_IEEE 0 PROJ_v0_CM_single_degC -3.4E+38 3.4E+38 NUMBER 10 /end CHARACTERISTIC
/begin CHARACTERISTIC SnsrTBattCoolt_TDegMinMax "" VAL_BLK 0xfd00e8 /* @ECU_Address@SnsrTBattCoolt_TDegMinMax@ */ Scalar_FLOAT32_IEEE 0 PROJ_v0_CM_single_degC -50.0 200.0 NUMBER 2 /end CHARACTERISTIC
/begin CHARACTERISTIC SnsrTBattCoolt_TdegOfs "Output temperature calibration offset" VALUE 0xfd00f0 /* @ECU_Address@SnsrTBattCoolt_TdegOfs@ */ Scalar_FLOAT32_IEEE 0 PROJ_v0_CM_single_degC -3.4E+38 3.4E+38 /end CHARACTERISTIC
/begin CHARACTERISTIC SnsrTBattCoolt_VoltMinMax "Input Voltage Operational range" VAL_BLK 0xfd00f4 /* @ECU_Address@SnsrTBattCoolt_VoltMinMax@ */ Scalar_FLOAT32_IEEE 0 PROJ_v0_CM_single_V 0.0 30.0 NUMBER 2 /end CHARACTERISTIC
/begin CHARACTERISTIC SnsrTBattCoolt_Vref "supplied voltage reference" VALUE 0xfd00fc /* @ECU_Address@SnsrTBattCoolt_Vref@ */ Scalar_FLOAT32_IEEE 0 PROJ_v0_CM_single_V 1.0 3.4E+38 /end CHARACTERISTIC
/begin CHARACTERISTIC Test_Actr_WP1_PmpSpdReqOvrCal_val "" VALUE 0xfd0114 /* @ECU_Address@Test_Actr_WP1_PmpSpdReqOvrCal_val@ */ Scalar_FLOAT32_IEEE 0 PROJ_v0_CM_single -3.4E+38 3.4E+38 /end CHARACTERISTIC
/begin CHARACTERISTIC Test_AnInpVolt_A01OvrCal_val "" VALUE 0xfd011c /* @ECU_Address@Test_AnInpVolt_A01OvrCal_val@ */ Scalar_FLOAT32_IEEE 0 PROJ_v0_CM_single_V -3.4E+38 3.4E+38 /end CHARACTERISTIC
/begin CHARACTERISTIC Test_AnInpVolt_A03OvrCal_val "" VALUE 0xfd0124 /* @ECU_Address@Test_AnInpVolt_A03OvrCal_val@ */ Scalar_FLOAT32_IEEE 0 PROJ_v0_CM_single_V -3.4E+38 3.4E+38 /end CHARACTERISTIC
/begin CHARACTERISTIC Test_AnInpVolt_A04OvrCal_val "" VALUE 0xfd012c /* @ECU_Address@Test_AnInpVolt_A04OvrCal_val@ */ Scalar_FLOAT32_IEEE 0 PROJ_v0_CM_single_V -3.4E+38 3.4E+38 /end CHARACTERISTIC
/begin CHARACTERISTIC Test_SnsrP_HiPSide_VoltOvrCal_val "" VALUE 0xfd0134 /* @ECU_Address@Test_SnsrP_HiPSide_VoltOvrCal_val@ */ Scalar_FLOAT32_IEEE 0 PROJ_v0_CM_single_V -3.4E+38 3.4E+38 /end CHARACTERISTIC
/begin CHARACTERISTIC Test_SnsrP_LoPSide_VoltOvrCal_val "" VALUE 0xfd013c /* @ECU_Address@Test_SnsrP_LoPSide_VoltOvrCal_val@ */ Scalar_FLOAT32_IEEE 0 PROJ_v0_CM_single_V -3.4E+38 3.4E+38 /end CHARACTERISTIC
/begin CHARACTERISTIC Test_SnsrT_BattCoolt_VoltOvrCal_val "" VALUE 0xfd0144 /* @ECU_Address@Test_SnsrT_BattCoolt_VoltOvrCal_val@ */ Scalar_FLOAT32_IEEE 0 PROJ_v0_CM_single_V -3.4E+38 3.4E+38 /end CHARACTERISTIC
/begin CHARACTERISTIC LIN_Id17_RxTout "" VALUE 0xfd0010 /* @ECU_Address@LIN_Id17_RxTout@ */ Scalar_UWORD 0 PROJ_v0_CM_uint16_ms 0 65535 /end CHARACTERISTIC
/begin CHARACTERISTIC LIN_Id5_RxTout "" VALUE 0xfd0012 /* @ECU_Address@LIN_Id5_RxTout@ */ Scalar_UWORD 0 PROJ_v0_CM_uint16_ms 0 65535 /end CHARACTERISTIC
/begin CHARACTERISTIC LIN_Id9_RxTout "" VALUE 0xfd0014 /* @ECU_Address@LIN_Id9_RxTout@ */ Scalar_UWORD 0 PROJ_v0_CM_uint16_ms 0 65535 /end CHARACTERISTIC
/begin CHARACTERISTIC FanDrvrFanRdyChkFlt "ready to run check fault st only" VALUE 0xfd000b /* @ECU_Address@FanDrvrFanRdyChkFlt@ */ Scalar_BOOLEAN 0 PROJ_v0_CM_boolean 0 1 /end CHARACTERISTIC
/begin CHARACTERISTIC PmpDrvrSpdFbSrc "" VALUE 0xfd0018 /* @ECU_Address@PmpDrvrSpdFbSrc@ */ Scalar_BOOLEAN 0 PROJ_v0_CM_boolean 0 1 /end CHARACTERISTIC
/begin CHARACTERISTIC PwrMCU_flgEnRestoreStoreNVM_val "" VALUE 0xfd001c /* @ECU_Address@PwrMCU_flgEnRestoreStoreNVM_val@ */ Scalar_BOOLEAN 0 PROJ_v0_CM_boolean 0 1 /end CHARACTERISTIC
/begin CHARACTERISTIC PwrMCU_flgResetSWEn_val "" VALUE 0xfd001d /* @ECU_Address@PwrMCU_flgResetSWEn_val@ */ Scalar_BOOLEAN 0 PROJ_v0_CM_boolean 0 1 /end CHARACTERISTIC
/begin CHARACTERISTIC SnsrTBattCoolt_SwtIntRes "" VALUE 0xfd00bc /* @ECU_Address@SnsrTBattCoolt_SwtIntRes@ */ Scalar_BOOLEAN 0 PROJ_v0_CM_boolean 0 1 /end CHARACTERISTIC
/begin CHARACTERISTIC Test_Actr_FanDrvrIsStOnOvrCal_val "" VALUE 0xfd0101 /* @ECU_Address@Test_Actr_FanDrvrIsStOnOvrCal_val@ */ Scalar_BOOLEAN 0 PROJ_v0_CM_boolean 0 1 /end CHARACTERISTIC
/begin CHARACTERISTIC Test_Actr_FanDrvrIsStOnOvrEn_val "Override Control" VALUE 0xfd0102 /* @ECU_Address@Test_Actr_FanDrvrIsStOnOvrEn_val@ */ Scalar_BOOLEAN 0 PROJ_v0_CM_boolean 0 1 /end CHARACTERISTIC
/begin CHARACTERISTIC Test_Actr_FanDrvrRdyOvrCal_val "" VALUE 0xfd0103 /* @ECU_Address@Test_Actr_FanDrvrRdyOvrCal_val@ */ Scalar_BOOLEAN 0 PROJ_v0_CM_boolean 0 1 /end CHARACTERISTIC
/begin CHARACTERISTIC Test_Actr_FanDrvrRdyOvrEn_val "Override Control" VALUE 0xfd0104 /* @ECU_Address@Test_Actr_FanDrvrRdyOvrEn_val@ */ Scalar_BOOLEAN 0 PROJ_v0_CM_boolean 0 1 /end CHARACTERISTIC
/begin CHARACTERISTIC Test_Actr_FanSpdReqOvrEn_val "Override Control" VALUE 0xfd0106 /* @ECU_Address@Test_Actr_FanSpdReqOvrEn_val@ */ Scalar_BOOLEAN 0 PROJ_v0_CM_boolean 0 1 /end CHARACTERISTIC
/begin CHARACTERISTIC Test_Actr_Soln1CmdOvrCal_val "" VALUE 0xfd0107 /* @ECU_Address@Test_Actr_Soln1CmdOvrCal_val@ */ Scalar_BOOLEAN 0 PROJ_v0_CM_boolean 0 1 /end CHARACTERISTIC
/begin CHARACTERISTIC Test_Actr_Soln1CmdOvrEn_val "Override Control" VALUE 0xfd0108 /* @ECU_Address@Test_Actr_Soln1CmdOvrEn_val@ */ Scalar_BOOLEAN 0 PROJ_v0_CM_boolean 0 1 /end CHARACTERISTIC
/begin CHARACTERISTIC Test_Actr_Soln2CmdOvrCal_val "" VALUE 0xfd0109 /* @ECU_Address@Test_Actr_Soln2CmdOvrCal_val@ */ Scalar_BOOLEAN 0 PROJ_v0_CM_boolean 0 1 /end CHARACTERISTIC
/begin CHARACTERISTIC Test_Actr_Soln2CmdOvrEn_val "Override Control" VALUE 0xfd010a /* @ECU_Address@Test_Actr_Soln2CmdOvrEn_val@ */ Scalar_BOOLEAN 0 PROJ_v0_CM_boolean 0 1 /end CHARACTERISTIC
/begin CHARACTERISTIC Test_Actr_V1_EnableOvrCal_val "" VALUE 0xfd010b /* @ECU_Address@Test_Actr_V1_EnableOvrCal_val@ */ Scalar_BOOLEAN 0 PROJ_v0_CM_boolean 0 1 /end CHARACTERISTIC
/begin CHARACTERISTIC Test_Actr_V1_MoveEnableOvrCal_val "" VALUE 0xfd010c /* @ECU_Address@Test_Actr_V1_MoveEnableOvrCal_val@ */ Scalar_BOOLEAN 0 PROJ_v0_CM_boolean 0 1 /end CHARACTERISTIC
/begin CHARACTERISTIC Test_Actr_V2_EnableOvrCal_val "" VALUE 0xfd010e /* @ECU_Address@Test_Actr_V2_EnableOvrCal_val@ */ Scalar_BOOLEAN 0 PROJ_v0_CM_boolean 0 1 /end CHARACTERISTIC
/begin CHARACTERISTIC Test_Actr_V2_MoveEnableOvrCal_val "" VALUE 0xfd010f /* @ECU_Address@Test_Actr_V2_MoveEnableOvrCal_val@ */ Scalar_BOOLEAN 0 PROJ_v0_CM_boolean 0 1 /end CHARACTERISTIC
/begin CHARACTERISTIC Test_Actr_WP1_PmpSpdReqOvrEn_val "Override Control" VALUE 0xfd0118 /* @ECU_Address@Test_Actr_WP1_PmpSpdReqOvrEn_val@ */ Scalar_BOOLEAN 0 PROJ_v0_CM_boolean 0 1 /end CHARACTERISTIC
/begin CHARACTERISTIC Test_AnInpVolt_A01OvrEn_val "Override Control" VALUE 0xfd0120 /* @ECU_Address@Test_AnInpVolt_A01OvrEn_val@ */ Scalar_BOOLEAN 0 PROJ_v0_CM_boolean 0 1 /end CHARACTERISTIC
/begin CHARACTERISTIC Test_AnInpVolt_A03OvrEn_val "Override Control" VALUE 0xfd0128 /* @ECU_Address@Test_AnInpVolt_A03OvrEn_val@ */ Scalar_BOOLEAN 0 PROJ_v0_CM_boolean 0 1 /end CHARACTERISTIC
/begin CHARACTERISTIC Test_AnInpVolt_A04OvrEn_val "Override Control" VALUE 0xfd0130 /* @ECU_Address@Test_AnInpVolt_A04OvrEn_val@ */ Scalar_BOOLEAN 0 PROJ_v0_CM_boolean 0 1 /end CHARACTERISTIC
/begin CHARACTERISTIC Test_SnsrP_HiPSide_VoltOvrEn_val "Override Control" VALUE 0xfd0138 /* @ECU_Address@Test_SnsrP_HiPSide_VoltOvrEn_val@ */ Scalar_BOOLEAN 0 PROJ_v0_CM_boolean 0 1 /end CHARACTERISTIC
/begin CHARACTERISTIC Test_SnsrP_LoPSide_VoltOvrEn_val "Override Control" VALUE 0xfd0140 /* @ECU_Address@Test_SnsrP_LoPSide_VoltOvrEn_val@ */ Scalar_BOOLEAN 0 PROJ_v0_CM_boolean 0 1 /end CHARACTERISTIC
/begin CHARACTERISTIC Test_SnsrT_BattCoolt_VoltOvrEn_val "Override Control" VALUE 0xfd0148 /* @ECU_Address@Test_SnsrT_BattCoolt_VoltOvrEn_val@ */ Scalar_BOOLEAN 0 PROJ_v0_CM_boolean 0 1 /end CHARACTERISTIC
/begin CHARACTERISTIC dbgMdlEna1Inp_val "Debug Model Enable Inputs" VALUE 0xfd0186 /* @ECU_Address@dbgMdlEna1Inp_val@ */ Scalar_BOOLEAN 0 PROJ_v0_CM_boolean 0 1 /end CHARACTERISTIC
/begin CHARACTERISTIC dbgMdlEna2App_val "Debug Model Enable Application Function" VALUE 0xfd0187 /* @ECU_Address@dbgMdlEna2App_val@ */ Scalar_BOOLEAN 0 PROJ_v0_CM_boolean 0 1 /end CHARACTERISTIC
/begin CHARACTERISTIC dbgMdlEna2Drvrs_val "Debug Model Enable Drivers Function" VALUE 0xfd0188 /* @ECU_Address@dbgMdlEna2Drvrs_val@ */ Scalar_BOOLEAN 0 PROJ_v0_CM_boolean 0 1 /end CHARACTERISTIC
/begin CHARACTERISTIC dbgMdlEna3OutHS_val "Debug Model Enable Outputs HS" VALUE 0xfd0189 /* @ECU_Address@dbgMdlEna3OutHS_val@ */ Scalar_BOOLEAN 0 PROJ_v0_CM_boolean 0 1 /end CHARACTERISTIC
/begin CHARACTERISTIC dbgMdlEna4OutCAN_val "Debug Model Enable Outputs CAN" VALUE 0xfd018a /* @ECU_Address@dbgMdlEna4OutCAN_val@ */ Scalar_BOOLEAN 0 PROJ_v0_CM_boolean 0 1 /end CHARACTERISTIC
/begin CHARACTERISTIC dbgMdlEna5InCAN_val "Debug Model Enable Input CAN" VALUE 0xfd018b /* @ECU_Address@dbgMdlEna5InCAN_val@ */ Scalar_BOOLEAN 0 PROJ_v0_CM_boolean 0 1 /end CHARACTERISTIC
/begin CHARACTERISTIC dbgMdlEna6Diag_val "Debug Model Enable Diagnostics reading" VALUE 0xfd018c /* @ECU_Address@dbgMdlEna6Diag_val@ */ Scalar_BOOLEAN 0 PROJ_v0_CM_boolean 0 1 /end CHARACTERISTIC
/begin CHARACTERISTIC dbgMdlEna7LIN_val "Debug Model Enable LIN" VALUE 0xfd018d /* @ECU_Address@dbgMdlEna7LIN_val@ */ Scalar_BOOLEAN 0 PROJ_v0_CM_boolean 0 1 /end CHARACTERISTIC
/begin CHARACTERISTIC dbgMdlEnaCANTx_TCU_VCU "" VALUE 0xfd018e /* @ECU_Address@dbgMdlEnaCANTx_TCU_VCU@ */ Scalar_BOOLEAN 0 PROJ_v0_CM_boolean 0 1 /end CHARACTERISTIC
/begin CHARACTERISTIC dbgMdlEnaCANTx_TCU_VCU_Faults "" VALUE 0xfd018f /* @ECU_Address@dbgMdlEnaCANTx_TCU_VCU_Faults@ */ Scalar_BOOLEAN 0 PROJ_v0_CM_boolean 0 1 /end CHARACTERISTIC
/begin CHARACTERISTIC dbgMdlEnaCANTx_TMS_ActrsCmd "" VALUE 0xfd0190 /* @ECU_Address@dbgMdlEnaCANTx_TMS_ActrsCmd@ */ Scalar_BOOLEAN 0 PROJ_v0_CM_boolean 0 1 /end CHARACTERISTIC
/begin CHARACTERISTIC dbgMdlEnaCANTx_TMS_ActrsDrvrInfo "" VALUE 0xfd0191 /* @ECU_Address@dbgMdlEnaCANTx_TMS_ActrsDrvrInfo@ */ Scalar_BOOLEAN 0 PROJ_v0_CM_boolean 0 1 /end CHARACTERISTIC
/begin CHARACTERISTIC dbgMdlEnaCANTx_TMS_CTRL_INFO1 "" VALUE 0xfd0192 /* @ECU_Address@dbgMdlEnaCANTx_TMS_CTRL_INFO1@ */ Scalar_BOOLEAN 0 PROJ_v0_CM_boolean 0 1 /end CHARACTERISTIC
/begin CHARACTERISTIC dbgMdlEnaCANTx_tms_test_info_1 "" VALUE 0xfd0193 /* @ECU_Address@dbgMdlEnaCANTx_tms_test_info_1@ */ Scalar_BOOLEAN 0 PROJ_v0_CM_boolean 0 1 /end CHARACTERISTIC
/begin CHARACTERISTIC dbgMdlEnaCANTx_tms_test_info_2 "" VALUE 0xfd0194 /* @ECU_Address@dbgMdlEnaCANTx_tms_test_info_2@ */ Scalar_BOOLEAN 0 PROJ_v0_CM_boolean 0 1 /end CHARACTERISTIC
/begin CHARACTERISTIC dbgMdlEnaDbgCANTx_To1A "" VALUE 0xfd0195 /* @ECU_Address@dbgMdlEnaDbgCANTx_To1A@ */ Scalar_BOOLEAN 0 PROJ_v0_CM_boolean 0 1 /end CHARACTERISTIC
/begin CHARACTERISTIC dbgMdlEnaDbgCANTx_To3C "" VALUE 0xfd0196 /* @ECU_Address@dbgMdlEnaDbgCANTx_To3C@ */ Scalar_BOOLEAN 0 PROJ_v0_CM_boolean 0 1 /end CHARACTERISTIC
/begin CHARACTERISTIC dbgMdlEnaDbgLIN2CAN "Enable Debug send LIN 2 CAN" VALUE 0xfd0197 /* @ECU_Address@dbgMdlEnaDbgLIN2CAN@ */ Scalar_BOOLEAN 0 PROJ_v0_CM_boolean 0 1 /end CHARACTERISTIC
/begin CHARACTERISTIC FanDrvrRunStMinSpdThd "run state min speed detection threshod" VALUE 0xfd000c /* @ECU_Address@FanDrvrRunStMinSpdThd@ */ Scalar_UBYTE 0 PROJ_v0_CM_uint8_per 0.0 100.0 /end CHARACTERISTIC
/begin CHARACTERISTIC FanDrvrSpdCtlrErr "" VALUE 0xfd000d /* @ECU_Address@FanDrvrSpdCtlrErr@ */ Scalar_UBYTE 0 PROJ_v0_CM_uint8_per 0.0 100.0 /end CHARACTERISTIC
/begin CHARACTERISTIC FanDrvrSpdReqRateLim "" VALUE 0xfd000e /* @ECU_Address@FanDrvrSpdReqRateLim@ */ Scalar_UBYTE 0 PROJ_v0_CM_uint8_percent__per_sec 0.0 100.0 /end CHARACTERISTIC
/begin CHARACTERISTIC PmpDrvrMinSpdRunThd "" VALUE 0xfd0016 /* @ECU_Address@PmpDrvrMinSpdRunThd@ */ Scalar_UBYTE 0 PROJ_v0_CM_uint8_per 0 255 /end CHARACTERISTIC
/begin CHARACTERISTIC PmpDrvrSpdErrThd "" VALUE 0xfd0017 /* @ECU_Address@PmpDrvrSpdErrThd@ */ Scalar_UBYTE 0 PROJ_v0_CM_uint8_per 0 255 /end CHARACTERISTIC
/begin CHARACTERISTIC PmpDrvrSpdMaxReq "" VALUE 0xfd0019 /* @ECU_Address@PmpDrvrSpdMaxReq@ */ Scalar_UBYTE 0 PROJ_v0_CM_uint8_per 0.0 100.0 /end CHARACTERISTIC
/begin CHARACTERISTIC PmpDrvrSpdMinReq "" VALUE 0xfd001a /* @ECU_Address@PmpDrvrSpdMinReq@ */ Scalar_UBYTE 0 PROJ_v0_CM_uint8_per 0.0 100.0 /end CHARACTERISTIC
/begin CHARACTERISTIC PmpDrvrSpdRateLim "" VALUE 0xfd001b /* @ECU_Address@PmpDrvrSpdRateLim@ */ Scalar_UBYTE 0 PROJ_v0_CM_uint8_percent__per_sec 0 255 /end CHARACTERISTIC
/begin CHARACTERISTIC SolDrvrCmdTout "" VALUE 0xfd0100 /* @ECU_Address@SolDrvrCmdTout@ */ Scalar_UBYTE 0 PROJ_v0_CM_uint8_sec 0 255 /end CHARACTERISTIC
/begin CHARACTERISTIC Test_Actr_FanSpdReqOvrCal_val "" VALUE 0xfd0105 /* @ECU_Address@Test_Actr_FanSpdReqOvrCal_val@ */ Scalar_UBYTE 0 PROJ_v0_CM_uint8_percent_ 0 255 /end CHARACTERISTIC
/begin CHARACTERISTIC Test_Actr_V1_PosSetReqOvrCal_val "" VALUE 0xfd010d /* @ECU_Address@Test_Actr_V1_PosSetReqOvrCal_val@ */ Scalar_UBYTE 0 PROJ_v0_CM_uint8 0 100.0 /end CHARACTERISTIC
/begin CHARACTERISTIC Test_Actr_V2_PosSetReqOvrCal_val "" VALUE 0xfd0110 /* @ECU_Address@Test_Actr_V2_PosSetReqOvrCal_val@ */ Scalar_UBYTE 0 PROJ_v0_CM_uint8 0 100.0 /end CHARACTERISTIC
/begin CHARACTERISTIC Vlv1DrvrPosnCtrlErrThd "valve position control error threshold" VALUE 0xfd0184 /* @ECU_Address@Vlv1DrvrPosnCtrlErrThd@ */ Scalar_UBYTE 0 PROJ_v0_CM_uint8_per 0.0 100.0 /end CHARACTERISTIC
/begin CHARACTERISTIC Vlv2DrvrPosnCtrlErrThd "valve position control error threshold" VALUE 0xfd0185 /* @ECU_Address@Vlv2DrvrPosnCtrlErrThd@ */ Scalar_UBYTE 0 PROJ_v0_CM_uint8_per 0.0 100.0 /end CHARACTERISTIC
/begin CHARACTERISTIC AcCmprDrvrMinSpdRunThd "" VALUE 0xfd0000 /* @ECU_Address@AcCmprDrvrMinSpdRunThd@ */ Scalar_UWORD 0 AcCmprDrvr_tcci_mdl_CM_uint16_rpm 0 65535 /end CHARACTERISTIC
/begin CHARACTERISTIC AcCmprDrvrSpdMaxReq "limit rpm, scale prc % into rpm" VALUE 0xfd0002 /* @ECU_Address@AcCmprDrvrSpdMaxReq@ */ Scalar_UWORD 0 AcCmprDrvr_tcci_mdl_CM_uint16_rpm 0.0 65535.0 /end CHARACTERISTIC
/begin CHARACTERISTIC AcCmprDrvrSpdMinReq "min limit rpm, scale prc % into rpm" VALUE 0xfd0004 /* @ECU_Address@AcCmprDrvrSpdMinReq@ */ Scalar_UWORD 0 AcCmprDrvr_tcci_mdl_CM_uint16_rpm 0.0 65535.0 /end CHARACTERISTIC
/begin CHARACTERISTIC AcCmprDrvrTest_CmdSetSpdOvrd "" VALUE 0xfd0008 /* @ECU_Address@AcCmprDrvrTest_CmdSetSpdOvrd@ */ Scalar_UWORD 0 AcCmprDrvr_tcci_mdl_CM_uint16 0 65535 /end CHARACTERISTIC
/begin CHARACTERISTIC AcCmprDrvrTest_CmdEnaOvrd "" VALUE 0xfd0007 /* @ECU_Address@AcCmprDrvrTest_CmdEnaOvrd@ */ Scalar_BOOLEAN 0 AcCmprDrvr_tcci_mdl_CM_boolean 0 1 /end CHARACTERISTIC
/begin CHARACTERISTIC AcCmprDrvrTest_OvrdEnad "" VALUE 0xfd000a /* @ECU_Address@AcCmprDrvrTest_OvrdEnad@ */ Scalar_BOOLEAN 0 AcCmprDrvr_tcci_mdl_CM_boolean 0 1 /end CHARACTERISTIC
/begin CHARACTERISTIC AcCmprDrvrSpdReqRateLim "" VALUE 0xfd0006 /* @ECU_Address@AcCmprDrvrSpdReqRateLim@ */ Scalar_UBYTE 0 AcCmprDrvr_tcci_mdl_CM_uint8_percent__per_sec 0.0 100.0 /end CHARACTERISTIC
/begin CHARACTERISTIC TmsBtmsModTHysThd1 "" VALUE 0xfd0154 /* @ECU_Address@TmsBtmsModTHysThd1@ */ Scalar_FLOAT32_IEEE 0 TcuApp0_CM_single_degC 0.0 3.4E+38 /end CHARACTERISTIC
/begin CHARACTERISTIC TmsBtmsModTHysThd2 "" VALUE 0xfd0158 /* @ECU_Address@TmsBtmsModTHysThd2@ */ Scalar_FLOAT32_IEEE 0 TcuApp0_CM_single_degC 0.0 3.4E+38 /end CHARACTERISTIC
/begin CHARACTERISTIC TmsHvacAcHiP_OperLvl "AC low pressure operating levels" VAL_BLK 0xfd0178 /* @ECU_Address@TmsHvacAcHiP_OperLvl@ */ Scalar_UWORD 0 TcuApp0_CM_uint16_kPa 0 65535 NUMBER 2 /end CHARACTERISTIC
/begin CHARACTERISTIC TmsHvacAcLoP_OperLvl "AC low pressure operating levels" VAL_BLK 0xfd017c /* @ECU_Address@TmsHvacAcLoP_OperLvl@ */ Scalar_UWORD 0 TcuApp0_CM_uint16_kPa 0 65535 NUMBER 2 /end CHARACTERISTIC
/begin CHARACTERISTIC TmsBtmsIsEnad "" VALUE 0xfd0152 /* @ECU_Address@TmsBtmsIsEnad@ */ Scalar_BOOLEAN 0 TcuApp0_CM_boolean 0 1 /end CHARACTERISTIC
/begin CHARACTERISTIC TmsBtmsSol1CmdVect "1 -circulation,2 - cooling, 3 - heating" VAL_BLK 0xfd0168 /* @ECU_Address@TmsBtmsSol1CmdVect@ */ Scalar_BOOLEAN 0 TcuApp0_CM_boolean 0 1 NUMBER 3 /end CHARACTERISTIC
/begin CHARACTERISTIC TmsBtmsSol2CmdVect "1 -circulation,2 - cooling, 3 - heating" VAL_BLK 0xfd016c /* @ECU_Address@TmsBtmsSol2CmdVect@ */ Scalar_BOOLEAN 0 TcuApp0_CM_boolean 0 1 NUMBER 3 /end CHARACTERISTIC
/begin CHARACTERISTIC TmsBtmsAcCmdVect "1: AC OFF/INIT/MIN, 2: AC ON/MAX" VAL_BLK 0xfd014c /* @ECU_Address@TmsBtmsAcCmdVect@ */ Scalar_UBYTE 0 TcuApp0_CM_uint8_per 0.0 100.0 NUMBER 2 /end CHARACTERISTIC
/begin CHARACTERISTIC TmsBtmsFanCmdVect "Mode: AC Min, AC Max" VAL_BLK 0xfd0150 /* @ECU_Address@TmsBtmsFanCmdVect@ */ Scalar_UBYTE 0 TcuApp0_CM_uint8_per 0.0 100.0 NUMBER 2 /end CHARACTERISTIC
/begin CHARACTERISTIC TmsBtmsModTLvl "Heating Circulation Cooling" VAL_BLK 0xfd015c /* @ECU_Address@TmsBtmsModTLvl@ */ Scalar_UBYTE 0 TcuApp0_CM_uint8_degC 0.0 255 NUMBER 2 /end CHARACTERISTIC
/begin CHARACTERISTIC TmsBtmsPmpCmdVect "1- init min spd, 2 -circulation,3 - cool min, 4 - cool max, 5 - heater" VAL_BLK 0xfd0160 /* @ECU_Address@TmsBtmsPmpCmdVect@ */ Scalar_UBYTE 0 TcuApp0_CM_uint8_per 0.0 100.0 NUMBER 5 /end CHARACTERISTIC
/begin CHARACTERISTIC TmsBtmsVlv1CmdVect "1 -circulation,2 - cooling, 3 - heating" VAL_BLK 0xfd0170 /* @ECU_Address@TmsBtmsVlv1CmdVect@ */ Scalar_UBYTE 0 TcuApp0_CM_uint8_per 0.0 100.0 NUMBER 3 /end CHARACTERISTIC
/begin CHARACTERISTIC TmsBtmsVlv2CmdVect "1 -circulation,2 - cooling, 3 - heating" VAL_BLK 0xfd0174 /* @ECU_Address@TmsBtmsVlv2CmdVect@ */ Scalar_UBYTE 0 TcuApp0_CM_uint8_per 0.0 100.0 NUMBER 3 /end CHARACTERISTIC
/begin CHARACTERISTIC TmsModHoldTmr "" VALUE 0xfd0180 /* @ECU_Address@TmsModHoldTmr@ */ Scalar_UBYTE 0 TcuApp0_CM_uint8_sec 0.0 255 /end CHARACTERISTIC
/begin CHARACTERISTIC TmsModInitTmr "timer to init systems for HVAC mode" VALUE 0xfd0181 /* @ECU_Address@TmsModInitTmr@ */ Scalar_UBYTE 0 TcuApp0_CM_uint8_sec 0.0 255 /end CHARACTERISTIC
/begin CHARACTERISTIC TmsModTranDebFilTmr "Mode Transition Debounce Filter timer" VALUE 0xfd0182 /* @ECU_Address@TmsModTranDebFilTmr@ */ Scalar_UBYTE 0 TcuApp0_CM_uint8_sec 0.0 255 /end CHARACTERISTIC
/begin CHARACTERISTIC TmsPmpMinRunTmr "" VALUE 0xfd0183 /* @ECU_Address@TmsPmpMinRunTmr@ */ Scalar_UBYTE 0 TcuApp0_CM_uint8_sec 0 255 /end CHARACTERISTIC
/begin MEASUREMENT Test_AnInpVolt_A01OvrMsr "" FLOAT32_IEEE PROJ_v0_CM_single_V 0 0 -3.4E+38 3.4E+38 ECU_ADDRESS 0x40008084 /* @ECU_Address@Test_AnInpVolt_A01OvrMsr@ */ /end MEASUREMENT
/begin MEASUREMENT Test_AnInpVolt_A03OvrMsr "" FLOAT32_IEEE PROJ_v0_CM_single_V 0 0 -3.4E+38 3.4E+38 ECU_ADDRESS 0x40008088 /* @ECU_Address@Test_AnInpVolt_A03OvrMsr@ */ /end MEASUREMENT
/begin MEASUREMENT Test_AnInpVolt_A04OvrMsr "" FLOAT32_IEEE PROJ_v0_CM_single_V 0 0 -3.4E+38 3.4E+38 ECU_ADDRESS 0x4000808c /* @ECU_Address@Test_AnInpVolt_A04OvrMsr@ */ /end MEASUREMENT
/begin MEASUREMENT Test_Actr_V1_Cmd_PosSetReqOvrMsr "" FLOAT32_IEEE PROJ_v0_CM_single 0 0 -3.4E+38 3.4E+38 ECU_ADDRESS 0x40008074 /* @ECU_Address@Test_Actr_V1_Cmd_PosSetReqOvrMsr@ */ /end MEASUREMENT
/begin MEASUREMENT Test_Actr_V2_Cmd_PosSetReqOvrMsr "" FLOAT32_IEEE PROJ_v0_CM_single 0 0 -3.4E+38 3.4E+38 ECU_ADDRESS 0x4000807c /* @ECU_Address@Test_Actr_V2_Cmd_PosSetReqOvrMsr@ */ /end MEASUREMENT
/begin MEASUREMENT Test_Actr_WP1_PmpSpdReqOvrMsr "" FLOAT32_IEEE PROJ_v0_CM_single 0 0 -3.4E+38 3.4E+38 ECU_ADDRESS 0x40008080 /* @ECU_Address@Test_Actr_WP1_PmpSpdReqOvrMsr@ */ /end MEASUREMENT
/begin MEASUREMENT Test_SnsrP_LoPSide_VoltOvrMsr "" FLOAT32_IEEE PROJ_v0_CM_single_V 0 0 0.0 24.0 ECU_ADDRESS 0x40008094 /* @ECU_Address@Test_SnsrP_LoPSide_VoltOvrMsr@ */ /end MEASUREMENT
/begin MEASUREMENT SnrsP_LoP_ElecBascFild "" FLOAT32_IEEE PROJ_v0_CM_single 0 0 -3.4E+38 3.4E+38 ECU_ADDRESS 0x40008050 /* @ECU_Address@SnrsP_LoP_ElecBascFild@ */ /end MEASUREMENT
/begin MEASUREMENT SnrsP_LoP_MeasdVal "" FLOAT32_IEEE PROJ_v0_CM_single 0 0 -3.4E+38 3.4E+38 ECU_ADDRESS 0x40008058 /* @ECU_Address@SnrsP_LoP_MeasdVal@ */ /end MEASUREMENT
/begin MEASUREMENT Test_SnsrP_HiPSide_VoltOvrMsr "" FLOAT32_IEEE PROJ_v0_CM_single_V 0 0 0.0 24.0 ECU_ADDRESS 0x40008090 /* @ECU_Address@Test_SnsrP_HiPSide_VoltOvrMsr@ */ /end MEASUREMENT
/begin MEASUREMENT SnrsP_HiP_ElecBascFild "" FLOAT32_IEEE PROJ_v0_CM_single 0 0 -3.4E+38 3.4E+38 ECU_ADDRESS 0x40008044 /* @ECU_Address@SnrsP_HiP_ElecBascFild@ */ /end MEASUREMENT
/begin MEASUREMENT SnrsP_HiP_MeasdVal "" FLOAT32_IEEE PROJ_v0_CM_single 0 0 -3.4E+38 3.4E+38 ECU_ADDRESS 0x4000804c /* @ECU_Address@SnrsP_HiP_MeasdVal@ */ /end MEASUREMENT
/begin MEASUREMENT Test_SnsrT_BattCoolt_VoltOvrMsr "" FLOAT32_IEEE PROJ_v0_CM_single_V 0 0 0.0 24.0 ECU_ADDRESS 0x40008098 /* @ECU_Address@Test_SnsrT_BattCoolt_VoltOvrMsr@ */ /end MEASUREMENT
/begin MEASUREMENT SnsrT_BattCoolt_ElecBascFild "" FLOAT32_IEEE PROJ_v0_CM_single 0 0 -3.4E+38 3.4E+38 ECU_ADDRESS 0x4000805c /* @ECU_Address@SnsrT_BattCoolt_ElecBascFild@ */ /end MEASUREMENT
/begin MEASUREMENT SnsrT_BattCoolt_MeasdVal "" FLOAT32_IEEE PROJ_v0_CM_single 0 0 -3.4E+38 3.4E+38 ECU_ADDRESS 0x40008064 /* @ECU_Address@SnsrT_BattCoolt_MeasdVal@ */ /end MEASUREMENT
/begin MEASUREMENT rxCAN_test1_SnsrPres_HiP_Volt "" FLOAT32_IEEE PROJ_v0_CM_single 0 0 -3.4E+38 3.4E+38 ECU_ADDRESS 0x400080c8 /* @ECU_Address@rxCAN_test1_SnsrPres_HiP_Volt@ */ /end MEASUREMENT
/begin MEASUREMENT rxLIN_V2_BFPVPosition "" FLOAT32_IEEE PROJ_v0_CM_single 0 0 -3.4E+38 3.4E+38 ECU_ADDRESS 0x400080ec /* @ECU_Address@rxLIN_V2_BFPVPosition@ */ /end MEASUREMENT
/begin MEASUREMENT rxLIN_V1_BFPVPosition "" FLOAT32_IEEE PROJ_v0_CM_single 0 0 -3.4E+38 3.4E+38 ECU_ADDRESS 0x400080e0 /* @ECU_Address@rxLIN_V1_BFPVPosition@ */ /end MEASUREMENT
/begin MEASUREMENT LIN_Id17_Rx_dT "" UWORD PROJ_v0_CM_uint16_ms 0 0 0 65535 ECU_ADDRESS 0x4000800e /* @ECU_Address@LIN_Id17_Rx_dT@ */ /end MEASUREMENT
/begin MEASUREMENT LIN_Id5_Rx_dT "" UWORD PROJ_v0_CM_uint16_ms 0 0 0 65535 ECU_ADDRESS 0x40008024 /* @ECU_Address@LIN_Id5_Rx_dT@ */ /end MEASUREMENT
/begin MEASUREMENT LIN_Id9_Rx_dT "" UWORD PROJ_v0_CM_uint16_ms 0 0 0 65535 ECU_ADDRESS 0x40008032 /* @ECU_Address@LIN_Id9_Rx_dT@ */ /end MEASUREMENT
/begin MEASUREMENT Test_Actr_Ac_CAN_SpeedCmdMsr "" UWORD PROJ_v0_CM_uint16 0 0 0 65535 ECU_ADDRESS 0x4000806a /* @ECU_Address@Test_Actr_Ac_CAN_SpeedCmdMsr@ */ /end MEASUREMENT
/begin MEASUREMENT LIN_status "" UBYTE PROJ_v0_CM_uint8 0 0 0 255 ECU_ADDRESS 0x4000803d /* @ECU_Address@LIN_status@ */ /end MEASUREMENT
/begin MEASUREMENT LIN_cntSchdler "" UBYTE PROJ_v0_CM_uint8 0 0 0 255 ECU_ADDRESS 0x4000803c /* @ECU_Address@LIN_cntSchdler@ */ /end MEASUREMENT
/begin MEASUREMENT LIN_Id5_Rx_data "" UBYTE PROJ_v0_CM_uint8 0 0 0 255 ARRAY_SIZE 8 ECU_ADDRESS 0x40008028 /* @ECU_Address@LIN_Id5_Rx_data@ */ /end MEASUREMENT
/begin MEASUREMENT LIN_Id5_RxRes "" UBYTE PROJ_v0_CM_uint8 0 0 0 255 ECU_ADDRESS 0x40008023 /* @ECU_Address@LIN_Id5_RxRes@ */ /end MEASUREMENT
/begin MEASUREMENT LIN_Id9_Rx_data "" UBYTE PROJ_v0_CM_uint8 0 0 0 255 ARRAY_SIZE 8 ECU_ADDRESS 0x40008034 /* @ECU_Address@LIN_Id9_Rx_data@ */ /end MEASUREMENT
/begin MEASUREMENT LIN_Id9_RxRes "" UBYTE PROJ_v0_CM_uint8 0 0 0 255 ECU_ADDRESS 0x40008030 /* @ECU_Address@LIN_Id9_RxRes@ */ /end MEASUREMENT
/begin MEASUREMENT rxLIN_Id17_data "" UBYTE PROJ_v0_CM_uint8 0 0 0 255 ARRAY_SIZE 8 ECU_ADDRESS 0x400080d0 /* @ECU_Address@rxLIN_Id17_data@ */ /end MEASUREMENT
/begin MEASUREMENT LIN_Id11_RxRes_WP_EDS2_Status_1 "" UBYTE PROJ_v0_CM_uint8 0 0 0 255 ECU_ADDRESS 0x4000800c /* @ECU_Address@LIN_Id11_RxRes_WP_EDS2_Status_1@ */ /end MEASUREMENT
/begin MEASUREMENT LIN_Id52_Rx_data "" UBYTE PROJ_v0_CM_uint8 0 0 0 255 ARRAY_SIZE 3 ECU_ADDRESS 0x40008020 /* @ECU_Address@LIN_Id52_Rx_data@ */ /end MEASUREMENT
/begin MEASUREMENT LIN_Id52_RxRes "" UBYTE PROJ_v0_CM_uint8 0 0 0 255 ECU_ADDRESS 0x4000801f /* @ECU_Address@LIN_Id52_RxRes@ */ /end MEASUREMENT
/begin MEASUREMENT LIN_Id39_Rx_data "" UBYTE PROJ_v0_CM_uint8 0 0 0 255 ARRAY_SIZE 7 ECU_ADDRESS 0x40008018 /* @ECU_Address@LIN_Id39_Rx_data@ */ /end MEASUREMENT
/begin MEASUREMENT LIN_Id39_RxRes "" UBYTE PROJ_v0_CM_uint8 0 0 0 255 ECU_ADDRESS 0x40008017 /* @ECU_Address@LIN_Id39_RxRes@ */ /end MEASUREMENT
/begin MEASUREMENT LIN_Id23_Rx_data "" UBYTE PROJ_v0_CM_uint8 0 0 0 255 ARRAY_SIZE 3 ECU_ADDRESS 0x40008014 /* @ECU_Address@LIN_Id23_Rx_data@ */ /end MEASUREMENT
/begin MEASUREMENT LIN_Id23_RxRes "" UBYTE PROJ_v0_CM_uint8 0 0 0 255 ECU_ADDRESS 0x40008010 /* @ECU_Address@LIN_Id23_RxRes@ */ /end MEASUREMENT
/begin MEASUREMENT DiagHSO_stLSO03 "" UBYTE PROJ_v0_CM_uint8 0 0 0 255 ECU_ADDRESS 0x40008008 /* @ECU_Address@DiagHSO_stLSO03@ */ /end MEASUREMENT
/begin MEASUREMENT DiagHSO_stLSO04 "" UBYTE PROJ_v0_CM_uint8 0 0 0 255 ECU_ADDRESS 0x40008009 /* @ECU_Address@DiagHSO_stLSO04@ */ /end MEASUREMENT
/begin MEASUREMENT DiagHSO_stLS01 "" UBYTE PROJ_v0_CM_uint8 0 0 0 255 ECU_ADDRESS 0x40008006 /* @ECU_Address@DiagHSO_stLS01@ */ /end MEASUREMENT
/begin MEASUREMENT DiagHSO_stLSO02 "" UBYTE PROJ_v0_CM_uint8 0 0 0 255 ECU_ADDRESS 0x40008007 /* @ECU_Address@DiagHSO_stLSO02@ */ /end MEASUREMENT
/begin MEASUREMENT DiagHSO_stLSO05 "" UBYTE PROJ_v0_CM_uint8 0 0 0 255 ECU_ADDRESS 0x4000800a /* @ECU_Address@DiagHSO_stLSO05@ */ /end MEASUREMENT
/begin MEASUREMENT DiagHSO_stHSO01 "" UBYTE PROJ_v0_CM_uint8 0 0 0 255 ECU_ADDRESS 0x40008002 /* @ECU_Address@DiagHSO_stHSO01@ */ /end MEASUREMENT
/begin MEASUREMENT DiagHSO_stHSO02 "" UBYTE PROJ_v0_CM_uint8 0 0 0 255 ECU_ADDRESS 0x40008003 /* @ECU_Address@DiagHSO_stHSO02@ */ /end MEASUREMENT
/begin MEASUREMENT DiagHSO_stHSO03 "" UBYTE PROJ_v0_CM_uint8 0 0 0 255 ECU_ADDRESS 0x40008004 /* @ECU_Address@DiagHSO_stHSO03@ */ /end MEASUREMENT
/begin MEASUREMENT DiagHSO_stHSO04 "" UBYTE PROJ_v0_CM_uint8 0 0 0 255 ECU_ADDRESS 0x40008005 /* @ECU_Address@DiagHSO_stHSO04@ */ /end MEASUREMENT
/begin MEASUREMENT CANAError_st "" UBYTE PROJ_v0_CM_uint8 0 0 0 255 ECU_ADDRESS 0x40008000 /* @ECU_Address@CANAError_st@ */ /end MEASUREMENT
/begin MEASUREMENT CANCError_st "" UBYTE PROJ_v0_CM_uint8 0 0 0 255 ECU_ADDRESS 0x40008001 /* @ECU_Address@CANCError_st@ */ /end MEASUREMENT
/begin MEASUREMENT rxCAN_RAW_TEST1_DATA "" UBYTE PROJ_v0_CM_uint8 0 0 0 255 ARRAY_SIZE 8 ECU_ADDRESS 0x400080b4 /* @ECU_Address@rxCAN_RAW_TEST1_DATA@ */ /end MEASUREMENT
/begin MEASUREMENT rxCAN_HMIHMISwRevision "" UBYTE PROJ_v0_CM_uint8 0 0 0 255 ECU_ADDRESS 0x400080a0 /* @ECU_Address@rxCAN_HMIHMISwRevision@ */ /end MEASUREMENT
/begin MEASUREMENT rxCAN_HMIHMISwVersion "" UBYTE PROJ_v0_CM_uint8 0 0 0 255 ECU_ADDRESS 0x400080a1 /* @ECU_Address@rxCAN_HMIHMISwVersion@ */ /end MEASUREMENT
/begin MEASUREMENT rxCAN_HMIHMIStatus "" UBYTE PROJ_v0_CM_uint8 0 0 0 255 ECU_ADDRESS 0x4000809f /* @ECU_Address@rxCAN_HMIHMIStatus@ */ /end MEASUREMENT
/begin MEASUREMENT rxCAN_HMIRecirPosFb "" UBYTE PROJ_v0_CM_uint8 0 0 0 255 ECU_ADDRESS 0x400080a4 /* @ECU_Address@rxCAN_HMIRecirPosFb@ */ /end MEASUREMENT
/begin MEASUREMENT rxCAN_HMIAirDistDirFb "" UBYTE PROJ_v0_CM_uint8 0 0 0 255 ECU_ADDRESS 0x4000809c /* @ECU_Address@rxCAN_HMIAirDistDirFb@ */ /end MEASUREMENT
/begin MEASUREMENT rxCAN_RAW_TCU_VCU_DATA "" UBYTE PROJ_v0_CM_uint8 0 0 0 255 ARRAY_SIZE 8 ECU_ADDRESS 0x400080a8 /* @ECU_Address@rxCAN_RAW_TCU_VCU_DATA@ */ /end MEASUREMENT
/begin MEASUREMENT rxLIN_PUMP_ErrRespBCPF "" UBYTE PROJ_v0_CM_uint8 0 0 0 255 ECU_ADDRESS 0x400080db /* @ECU_Address@rxLIN_PUMP_ErrRespBCPF@ */ /end MEASUREMENT
/begin MEASUREMENT rxLIN_PUMP_Eds2PmpStatCooltPmpErrSts "" UBYTE PROJ_v0_CM_uint8 0 0 0 255 ECU_ADDRESS 0x400080d8 /* @ECU_Address@rxLIN_PUMP_Eds2PmpStatCooltPmpErrSts@ */ /end MEASUREMENT
/begin MEASUREMENT rxLIN_PUMP_Eds2PmpStatCooltPmpSpd "" UBYTE PROJ_v0_CM_uint8 0 0 0 255 ECU_ADDRESS 0x400080da /* @ECU_Address@rxLIN_PUMP_Eds2PmpStatCooltPmpSpd@ */ /end MEASUREMENT
/begin MEASUREMENT rxLIN_PUMP_Eds2PmpStatCooltPmpSetSpdReq "" UBYTE PROJ_v0_CM_uint8 0 0 0 255 ECU_ADDRESS 0x400080d9 /* @ECU_Address@rxLIN_PUMP_Eds2PmpStatCooltPmpSetSpdReq@ */ /end MEASUREMENT
/begin MEASUREMENT Test_Actr_Ac_DrvrSpdCmdSpMsr "" UBYTE PROJ_v0_CM_uint8 0 0 0 255 ECU_ADDRESS 0x4000806c /* @ECU_Address@Test_Actr_Ac_DrvrSpdCmdSpMsr@ */ /end MEASUREMENT
/begin MEASUREMENT Test_Actr_FanSpdReqOvrMsr "" UBYTE PROJ_v0_CM_uint8_percent_ 0 0 0 255 ECU_ADDRESS 0x4000806f /* @ECU_Address@Test_Actr_FanSpdReqOvrMsr@ */ /end MEASUREMENT
/begin MEASUREMENT rxCAN_test0_PumpSpdOvrd_cmd_prc "" UBYTE PROJ_v0_CM_uint8 0 0 0 255 ECU_ADDRESS 0x400080c5 /* @ECU_Address@rxCAN_test0_PumpSpdOvrd_cmd_prc@ */ /end MEASUREMENT
/begin MEASUREMENT rxCAN_VCUTCU_ClimateModeReq "" UBYTE PROJ_v0_CM_uint8 0 0 0 255 ECU_ADDRESS 0x400080bf /* @ECU_Address@rxCAN_VCUTCU_ClimateModeReq@ */ /end MEASUREMENT
/begin MEASUREMENT rxCAN_VCUTCU_CondFanSpFb "" UBYTE PROJ_v0_CM_uint8 0 0 0 255 ECU_ADDRESS 0x400080c0 /* @ECU_Address@rxCAN_VCUTCU_CondFanSpFb@ */ /end MEASUREMENT
/begin MEASUREMENT rxCAN_VCUTCU_CondFanStatus "" UBYTE PROJ_v0_CM_uint8 0 0 0 255 ECU_ADDRESS 0x400080c1 /* @ECU_Address@rxCAN_VCUTCU_CondFanStatus@ */ /end MEASUREMENT
/begin MEASUREMENT rxCAN_VCUTCU_BatteryTargetTemp "" UBYTE PROJ_v0_CM_uint8 0 0 0 255 ECU_ADDRESS 0x400080be /* @ECU_Address@rxCAN_VCUTCU_BatteryTargetTemp@ */ /end MEASUREMENT
/begin MEASUREMENT rxLIN_V2_BFPVVoltageStatus "" UBYTE PROJ_v0_CM_uint8 0 0 0 255 ECU_ADDRESS 0x400080f2 /* @ECU_Address@rxLIN_V2_BFPVVoltageStatus@ */ /end MEASUREMENT
/begin MEASUREMENT rxLIN_V2_BFPVStatus "" UBYTE PROJ_v0_CM_uint8 0 0 0 255 ECU_ADDRESS 0x400080f0 /* @ECU_Address@rxLIN_V2_BFPVStatus@ */ /end MEASUREMENT
/begin MEASUREMENT rxLIN_V1_BFPVVoltageStatus "" UBYTE PROJ_v0_CM_uint8 0 0 0 255 ECU_ADDRESS 0x400080e6 /* @ECU_Address@rxLIN_V1_BFPVVoltageStatus@ */ /end MEASUREMENT
/begin MEASUREMENT rxLIN_V1_BFPVStatus "" UBYTE PROJ_v0_CM_uint8 0 0 0 255 ECU_ADDRESS 0x400080e4 /* @ECU_Address@rxLIN_V1_BFPVStatus@ */ /end MEASUREMENT
/begin MEASUREMENT SnsrT_BattCoolt_FaultCode "" UBYTE PROJ_v0_CM_uint8 0 0 0 255 ECU_ADDRESS 0x40008060 /* @ECU_Address@SnsrT_BattCoolt_FaultCode@ */ /end MEASUREMENT
/begin MEASUREMENT SnrsP_LoP_FaultCode "" UBYTE PROJ_v0_CM_uint8 0 0 0 255 ECU_ADDRESS 0x40008054 /* @ECU_Address@SnrsP_LoP_FaultCode@ */ /end MEASUREMENT
/begin MEASUREMENT SnrsP_HiP_FaultCode "" UBYTE PROJ_v0_CM_uint8 0 0 0 255 ECU_ADDRESS 0x40008048 /* @ECU_Address@SnrsP_HiP_FaultCode@ */ /end MEASUREMENT
/begin MEASUREMENT PwrMCU_flgKeyOnRaw "" UBYTE PROJ_v0_CM_boolean 0 0 0 1 ECU_ADDRESS 0x40008040 /* @ECU_Address@PwrMCU_flgKeyOnRaw@ */ /end MEASUREMENT
/begin MEASUREMENT PwrMCU_flgKeyOff "" UBYTE PROJ_v0_CM_boolean 0 0 0 1 ECU_ADDRESS 0x4000803e /* @ECU_Address@PwrMCU_flgKeyOff@ */ /end MEASUREMENT
/begin MEASUREMENT PwrMCU_flgKeyOn "" UBYTE PROJ_v0_CM_boolean 0 0 0 1 ECU_ADDRESS 0x4000803f /* @ECU_Address@PwrMCU_flgKeyOn@ */ /end MEASUREMENT
/begin MEASUREMENT LIN_BusIdel_Flg "" UBYTE PROJ_v0_CM_boolean 0 0 0 1 ECU_ADDRESS 0x4000800b /* @ECU_Address@LIN_BusIdel_Flg@ */ /end MEASUREMENT
/begin MEASUREMENT txCAN_RAW_IsMsgAvl_TCU_VCU "" UBYTE PROJ_v0_CM_boolean 0 0 0 1 ECU_ADDRESS 0x400080f5 /* @ECU_Address@txCAN_RAW_IsMsgAvl_TCU_VCU@ */ /end MEASUREMENT
/begin MEASUREMENT txCAN_RAW_IsMsgAvl_TCU_VCU_Faults "" UBYTE PROJ_v0_CM_boolean 0 0 0 1 ECU_ADDRESS 0x400080f6 /* @ECU_Address@txCAN_RAW_IsMsgAvl_TCU_VCU_Faults@ */ /end MEASUREMENT
/begin MEASUREMENT txCAN_RAW_IsMsgAvl_TMS_ActrsCmd "" UBYTE PROJ_v0_CM_boolean 0 0 0 1 ECU_ADDRESS 0x400080f7 /* @ECU_Address@txCAN_RAW_IsMsgAvl_TMS_ActrsCmd@ */ /end MEASUREMENT
/begin MEASUREMENT txCAN_RAW_IsMsgAvl_tms_test_info_1 "" UBYTE PROJ_v0_CM_boolean 0 0 0 1 ECU_ADDRESS 0x400080f8 /* @ECU_Address@txCAN_RAW_IsMsgAvl_tms_test_info_1@ */ /end MEASUREMENT
/begin MEASUREMENT txCAN_RAW_IsMsgAvl_AC_Message "" UBYTE PROJ_v0_CM_boolean 0 0 0 1 ECU_ADDRESS 0x400080f4 /* @ECU_Address@txCAN_RAW_IsMsgAvl_AC_Message@ */ /end MEASUREMENT
/begin MEASUREMENT rxCAN_RAW_TEST2_AVL "" UBYTE PROJ_v0_CM_boolean 0 0 0 1 ECU_ADDRESS 0x400080bc /* @ECU_Address@rxCAN_RAW_TEST2_AVL@ */ /end MEASUREMENT
/begin MEASUREMENT rxCAN_RAW_TEST1_AVL "" UBYTE PROJ_v0_CM_boolean 0 0 0 1 ECU_ADDRESS 0x400080b0 /* @ECU_Address@rxCAN_RAW_TEST1_AVL@ */ /end MEASUREMENT
/begin MEASUREMENT rxCAN_HMIEvapTempSnFault "" UBYTE PROJ_v0_CM_boolean 0 0 0 1 ECU_ADDRESS 0x4000809d /* @ECU_Address@rxCAN_HMIEvapTempSnFault@ */ /end MEASUREMENT
/begin MEASUREMENT rxCAN_HMIMixAirTempSnFault "" UBYTE PROJ_v0_CM_boolean 0 0 0 1 ECU_ADDRESS 0x400080a3 /* @ECU_Address@rxCAN_HMIMixAirTempSnFault@ */ /end MEASUREMENT
/begin MEASUREMENT rxCAN_HMIExAmTempSnFault "" UBYTE PROJ_v0_CM_boolean 0 0 0 1 ECU_ADDRESS 0x4000809e /* @ECU_Address@rxCAN_HMIExAmTempSnFault@ */ /end MEASUREMENT
/begin MEASUREMENT rxCAN_HMIInCabTempSnFault "" UBYTE PROJ_v0_CM_boolean 0 0 0 1 ECU_ADDRESS 0x400080a2 /* @ECU_Address@rxCAN_HMIInCabTempSnFault@ */ /end MEASUREMENT
/begin MEASUREMENT rxCAN_RAW_AC1_AVL "" UBYTE PROJ_v0_CM_boolean 0 0 0 1 ECU_ADDRESS 0x400080a5 /* @ECU_Address@rxCAN_RAW_AC1_AVL@ */ /end MEASUREMENT
/begin MEASUREMENT rxCAN_RAW_TCU_VCU_AVL "" UBYTE PROJ_v0_CM_boolean 0 0 0 1 ECU_ADDRESS 0x400080a6 /* @ECU_Address@rxCAN_RAW_TCU_VCU_AVL@ */ /end MEASUREMENT
/begin MEASUREMENT Test_Actr_Ac_CAN_EnaCmdMsr "" UBYTE PROJ_v0_CM_boolean 0 0 0 1 ECU_ADDRESS 0x40008068 /* @ECU_Address@Test_Actr_Ac_CAN_EnaCmdMsr@ */ /end MEASUREMENT
/begin MEASUREMENT Test_Actr_Soln1CmdOvrMsr "" UBYTE PROJ_v0_CM_boolean 0 0 0 1 ECU_ADDRESS 0x40008070 /* @ECU_Address@Test_Actr_Soln1CmdOvrMsr@ */ /end MEASUREMENT
/begin MEASUREMENT Test_Actr_Soln2CmdOvrMsr "" UBYTE PROJ_v0_CM_boolean 0 0 0 1 ECU_ADDRESS 0x40008071 /* @ECU_Address@Test_Actr_Soln2CmdOvrMsr@ */ /end MEASUREMENT
/begin MEASUREMENT Test_Actr_FanDrvrIsStOnOvrMsr "" UBYTE PROJ_v0_CM_boolean 0 0 0 1 ECU_ADDRESS 0x4000806d /* @ECU_Address@Test_Actr_FanDrvrIsStOnOvrMsr@ */ /end MEASUREMENT
/begin MEASUREMENT Test_Actr_FanDrvrRdyOvrMsr "" UBYTE PROJ_v0_CM_boolean 0 0 0 1 ECU_ADDRESS 0x4000806e /* @ECU_Address@Test_Actr_FanDrvrRdyOvrMsr@ */ /end MEASUREMENT
/begin MEASUREMENT rxCAN_test2_MsgAvl "" UBYTE PROJ_v0_CM_boolean 0 0 0 1 ECU_ADDRESS 0x400080cd /* @ECU_Address@rxCAN_test2_MsgAvl@ */ /end MEASUREMENT
/begin MEASUREMENT rxCAN_test1_SnsrPres_HiP_Volt_IsOvrd "" UBYTE PROJ_v0_CM_boolean 0 0 0 1 ECU_ADDRESS 0x400080cc /* @ECU_Address@rxCAN_test1_SnsrPres_HiP_Volt_IsOvrd@ */ /end MEASUREMENT
/begin MEASUREMENT rxCAN_test0_MsgAvl "" UBYTE PROJ_v0_CM_boolean 0 0 0 1 ECU_ADDRESS 0x400080c3 /* @ECU_Address@rxCAN_test0_MsgAvl@ */ /end MEASUREMENT
/begin MEASUREMENT rxCAN_test0_PumpSpdOvrd_IsCmdOvrd "" UBYTE PROJ_v0_CM_boolean 0 0 0 1 ECU_ADDRESS 0x400080c4 /* @ECU_Address@rxCAN_test0_PumpSpdOvrd_IsCmdOvrd@ */ /end MEASUREMENT
/begin MEASUREMENT rxCAN_VCUTCU_IsMsgAvl "" UBYTE PROJ_v0_CM_boolean 0 0 0 1 ECU_ADDRESS 0x400080c2 /* @ECU_Address@rxCAN_VCUTCU_IsMsgAvl@ */ /end MEASUREMENT
/begin MEASUREMENT rxCAN_VCUTCU_BTMS_Enable "" UBYTE PROJ_v0_CM_boolean 0 0 0 1 ECU_ADDRESS 0x400080bd /* @ECU_Address@rxCAN_VCUTCU_BTMS_Enable@ */ /end MEASUREMENT
/begin MEASUREMENT Test_Actr_V1_CmdMoveEnableOvrMsr "" UBYTE PROJ_v0_CM_boolean 0 0 0 1 ECU_ADDRESS 0x40008072 /* @ECU_Address@Test_Actr_V1_CmdMoveEnableOvrMsr@ */ /end MEASUREMENT
/begin MEASUREMENT Test_Actr_V2_CmdMoveEnableOvrMsr "" UBYTE PROJ_v0_CM_boolean 0 0 0 1 ECU_ADDRESS 0x40008078 /* @ECU_Address@Test_Actr_V2_CmdMoveEnableOvrMsr@ */ /end MEASUREMENT
/begin MEASUREMENT rxLIN_V2_BFPVMoveStatus "" UBYTE PROJ_v0_CM_boolean 0 0 0 1 ECU_ADDRESS 0x400080e8 /* @ECU_Address@rxLIN_V2_BFPVMoveStatus@ */ /end MEASUREMENT
/begin MEASUREMENT rxLIN_V2_BFPVTempWarn "" UBYTE PROJ_v0_CM_boolean 0 0 0 1 ECU_ADDRESS 0x400080f1 /* @ECU_Address@rxLIN_V2_BFPVTempWarn@ */ /end MEASUREMENT
/begin MEASUREMENT rxLIN_V2_BFPV_ErrorResp "" UBYTE PROJ_v0_CM_boolean 0 0 0 1 ECU_ADDRESS 0x400080f3 /* @ECU_Address@rxLIN_V2_BFPV_ErrorResp@ */ /end MEASUREMENT
/begin MEASUREMENT rxLIN_V1_BFPVMoveStatus "" UBYTE PROJ_v0_CM_boolean 0 0 0 1 ECU_ADDRESS 0x400080dc /* @ECU_Address@rxLIN_V1_BFPVMoveStatus@ */ /end MEASUREMENT
/begin MEASUREMENT rxLIN_V1_BFPVTempWarn "" UBYTE PROJ_v0_CM_boolean 0 0 0 1 ECU_ADDRESS 0x400080e5 /* @ECU_Address@rxLIN_V1_BFPVTempWarn@ */ /end MEASUREMENT
/begin MEASUREMENT rxLIN_V1_BFPV_ErrorResp "" UBYTE PROJ_v0_CM_boolean 0 0 0 1 ECU_ADDRESS 0x400080e7 /* @ECU_Address@rxLIN_V1_BFPV_ErrorResp@ */ /end MEASUREMENT
/begin COMPU_METHOD PROJ_v0_CM_single_s "Q = V" RAT_FUNC "%8.6" "s" COEFFS 0 1 0 0 0 1 /end COMPU_METHOD
/begin COMPU_METHOD PROJ_v0_CM_single_sec "Q = V" RAT_FUNC "%8.6" "sec" COEFFS 0 1 0 0 0 1 /end COMPU_METHOD
/begin COMPU_METHOD PROJ_v0_CM_single_kPa "Q = V" RAT_FUNC "%8.6" "kPa" COEFFS 0 1 0 0 0 1 /end COMPU_METHOD
/begin COMPU_METHOD PROJ_v0_CM_single "Q = V" RAT_FUNC "%8.6" "" COEFFS 0 1 0 0 0 1 /end COMPU_METHOD
/begin COMPU_METHOD PROJ_v0_CM_single_V "Q = V" RAT_FUNC "%8.6" "V" COEFFS 0 1 0 0 0 1 /end COMPU_METHOD
/begin COMPU_METHOD PROJ_v0_CM_single_Ohm "Q = V" RAT_FUNC "%8.6" "Ohm" COEFFS 0 1 0 0 0 1 /end COMPU_METHOD
/begin COMPU_METHOD PROJ_v0_CM_single_kOhm "Q = V" RAT_FUNC "%8.6" "kOhm" COEFFS 0 1 0 0 0 1 /end COMPU_METHOD
/begin COMPU_METHOD PROJ_v0_CM_single_degC "Q = V" RAT_FUNC "%8.6" "degC" COEFFS 0 1 0 0 0 1 /end COMPU_METHOD
/begin COMPU_METHOD PROJ_v0_CM_uint16_ms "Q = V" RAT_FUNC "%5.0" "ms" COEFFS 0 1 0 0 0 1 /end COMPU_METHOD
/begin COMPU_METHOD PROJ_v0_CM_boolean "Q = V" RAT_FUNC "%1.0" "" COEFFS 0 1 0 0 0 1 /end COMPU_METHOD
/begin COMPU_METHOD PROJ_v0_CM_uint8_per "Q = V" RAT_FUNC "%3.0" "per" COEFFS 0 1 0 0 0 1 /end COMPU_METHOD
/begin COMPU_METHOD PROJ_v0_CM_uint8_percent__per_sec "Q = V" RAT_FUNC "%3.0" "%/sec" COEFFS 0 1 0 0 0 1 /end COMPU_METHOD
/begin COMPU_METHOD PROJ_v0_CM_uint8_sec "Q = V" RAT_FUNC "%3.0" "sec" COEFFS 0 1 0 0 0 1 /end COMPU_METHOD
/begin COMPU_METHOD PROJ_v0_CM_uint8_percent_ "Q = V" RAT_FUNC "%3.0" "%" COEFFS 0 1 0 0 0 1 /end COMPU_METHOD
/begin COMPU_METHOD PROJ_v0_CM_uint8 "Q = V" RAT_FUNC "%3.0" "" COEFFS 0 1 0 0 0 1 /end COMPU_METHOD
/begin COMPU_METHOD PROJ_v0_CM_uint16 "Q = V" RAT_FUNC "%5.0" "" COEFFS 0 1 0 0 0 1 /end COMPU_METHOD
/begin COMPU_METHOD AcCmprDrvr_tcci_mdl_CM_uint16_rpm "Q = V" RAT_FUNC "%5.0" "rpm" COEFFS 0 1 0 0 0 1 /end COMPU_METHOD
/begin COMPU_METHOD AcCmprDrvr_tcci_mdl_CM_uint16 "Q = V" RAT_FUNC "%5.0" "" COEFFS 0 1 0 0 0 1 /end COMPU_METHOD
/begin COMPU_METHOD AcCmprDrvr_tcci_mdl_CM_boolean "Q = V" RAT_FUNC "%1.0" "" COEFFS 0 1 0 0 0 1 /end COMPU_METHOD
/begin COMPU_METHOD AcCmprDrvr_tcci_mdl_CM_uint8_percent__per_sec "Q = V" RAT_FUNC "%3.0" "%/sec" COEFFS 0 1 0 0 0 1 /end COMPU_METHOD
/begin COMPU_METHOD TcuApp0_CM_single_degC "Q = V" RAT_FUNC "%8.6" "degC" COEFFS 0 1 0 0 0 1 /end COMPU_METHOD
/begin COMPU_METHOD TcuApp0_CM_uint16_kPa "Q = V" RAT_FUNC "%5.0" "kPa" COEFFS 0 1 0 0 0 1 /end COMPU_METHOD
/begin COMPU_METHOD TcuApp0_CM_boolean "Q = V" RAT_FUNC "%1.0" "" COEFFS 0 1 0 0 0 1 /end COMPU_METHOD
/begin COMPU_METHOD TcuApp0_CM_uint8_per "Q = V" RAT_FUNC "%3.0" "per" COEFFS 0 1 0 0 0 1 /end COMPU_METHOD
/begin COMPU_METHOD TcuApp0_CM_uint8_degC "Q = V" RAT_FUNC "%3.0" "degC" COEFFS 0 1 0 0 0 1 /end COMPU_METHOD
/begin COMPU_METHOD TcuApp0_CM_uint8_sec "Q = V" RAT_FUNC "%3.0" "sec" COEFFS 0 1 0 0 0 1 /end COMPU_METHOD
/begin GROUP PROJ_v0 "PROJ_v0" /* Root */ ROOT /begin SUB_GROUP Root_ASW1 Root_ECU_POWER_CONTROL /end SUB_GROUP /end GROUP
/begin GROUP Root_ASW1 "PROJ_v0/ASW1"
 /begin SUB_GROUP S1_APP S1_CAN_RECV S1_CAN_SND S1_DIAGNOSTICS S1_INPUTS_RECV S1_LIN S1_OUTPUTS /end SUB_GROUP
/end GROUP
/begin GROUP Root_ECU_POWER_CONTROL "PROJ_v0/ECU_POWER_CONTROL" /begin SUB_GROUP S3_General_Power_Control S3_Get_wake_up_signal /end SUB_GROUP /end GROUP
/begin GROUP S1_APP "PROJ_v0/ASW1/APP" /begin SUB_GROUP S5_modelApp_fun /end SUB_GROUP /end GROUP
/begin GROUP S1_CAN_RECV "PROJ_v0/ASW1/CAN_RECV" /begin SUB_GROUP S7_Subsystem /end SUB_GROUP /begin REF_CHARACTERISTIC dbgMdlEna5InCAN_val /end REF_CHARACTERISTIC /end GROUP
/begin GROUP S1_CAN_SND "PROJ_v0/ASW1/CAN_SND" /begin SUB_GROUP S8_CAN_SEND /end SUB_GROUP /begin REF_CHARACTERISTIC dbgMdlEna4OutCAN_val /end REF_CHARACTERISTIC /end GROUP
/begin GROUP S1_DIAGNOSTICS "PROJ_v0/ASW1/DIAGNOSTICS" /begin SUB_GROUP S9_Function_Call_Subsystem S9_RecoverCANBusOff_ /end SUB_GROUP /end GROUP
/begin GROUP S1_INPUTS_RECV "PROJ_v0/ASW1/INPUTS_RECV" /begin SUB_GROUP S10_SENSORS_INPUT_SIGS /end SUB_GROUP /end GROUP
/begin GROUP S1_LIN "PROJ_v0/ASW1/LIN" /begin SUB_GROUP S11_Subsystem1 /end SUB_GROUP /begin REF_CHARACTERISTIC dbgMdlEna7LIN_val /end REF_CHARACTERISTIC /end GROUP
/begin GROUP S1_OUTPUTS "PROJ_v0/ASW1/OUTPUTS" /begin SUB_GROUP S12_HS_control /end SUB_GROUP /end GROUP
/begin GROUP S3_General_Power_Control "PROJ_v0/ECU_POWER_CONTROL/General Power Control"
 /begin SUB_GROUP S438_Control_KeyCycle S438_Debounce_KeyOn S438_Shut_Down_MCU /end SUB_GROUP
 /begin REF_CHARACTERISTIC PwrMCU_flgEnRestoreStoreNVM_val /end REF_CHARACTERISTIC
/end GROUP
/begin GROUP S3_Get_wake_up_signal "PROJ_v0/ECU_POWER_CONTROL/Get wake-up signal" /begin SUB_GROUP S439_Get_wake_up_signal /end SUB_GROUP /end GROUP
/begin GROUP S5_modelApp_fun "PROJ_v0/ASW1/APP/modelApp_fun" /begin SUB_GROUP S13_APP_FUN_MODEL /end SUB_GROUP /end GROUP
/begin GROUP S7_Subsystem "PROJ_v0/ASW1/CAN_RECV/Subsystem"
 /begin SUB_GROUP S214_SEND_CAN_DEBUG_CAN_1A_ONLY1 S214_SEND_CAN_DEBUG_CAN_1A_ONLY3 S214_SEND_CAN_DEBUG_CAN_1A_ONLY4 S214_Subsystem S214_Subsystem1 /end SUB_GROUP
 /begin REF_MEASUREMENT rxCAN_HMIAirDistDirFb rxCAN_HMIEvapTempSnFault rxCAN_HMIExAmTempSnFault rxCAN_HMIHMIStatus rxCAN_HMIHMISwRevision rxCAN_HMIHMISwVersion rxCAN_HMIInCabTempSnFault rxCAN_HMIMixAirTempSnFault rxCAN_HMIRecirPosFb rxCAN_RAW_TEST1_AVL rxCAN_RAW_TEST1_DATA rxCAN_RAW_TEST2_AVL /end REF_MEASUREMENT
/end GROUP
/begin GROUP S8_CAN_SEND "PROJ_v0/ASW1/CAN_SND/CAN_SEND" /begin SUB_GROUP S248_Subsystem1 S248_Subsystem2 S248_Subsystem3 /end SUB_GROUP /end GROUP
/begin GROUP S9_Function_Call_Subsystem "PROJ_v0/ASW1/DIAGNOSTICS/Function-Call Subsystem" /begin SUB_GROUP S302_Diag /end SUB_GROUP /begin REF_CHARACTERISTIC dbgMdlEna6Diag_val /end REF_CHARACTERISTIC /end GROUP
/begin GROUP S9_RecoverCANBusOff_ "PROJ_v0/ASW1/DIAGNOSTICS/RecoverCANBusOff " /begin REF_MEASUREMENT CANAError_st CANCError_st /end REF_MEASUREMENT /end GROUP
/begin GROUP S10_SENSORS_INPUT_SIGS "PROJ_v0/ASW1/INPUTS_RECV/SENSORS_INPUT_SIGS" /begin SUB_GROUP S318_sensors_read /end SUB_GROUP /begin REF_CHARACTERISTIC dbgMdlEna1Inp_val /end REF_CHARACTERISTIC /end GROUP
/begin GROUP S11_Subsystem1 "PROJ_v0/ASW1/LIN/Subsystem1" /begin SUB_GROUP S326_RTX /end SUB_GROUP /end GROUP
/begin GROUP S12_HS_control "PROJ_v0/ASW1/OUTPUTS/HS_control" /begin REF_CHARACTERISTIC dbgMdlEna3OutHS_val /end REF_CHARACTERISTIC /end GROUP
/begin GROUP S438_Control_KeyCycle "PROJ_v0/ECU_POWER_CONTROL/General Power Control/Control KeyCycle"
 /begin REF_CHARACTERISTIC PwrMCU_flgResetSWEn_val PwrMCU_tResetDbncKeyOffFall_val PwrMCU_tResetDbncKeyOffRise_val /end REF_CHARACTERISTIC
/end GROUP
/begin GROUP S438_Debounce_KeyOn "PROJ_v0/ECU_POWER_CONTROL/General Power Control/Debounce KeyOn" /begin SUB_GROUP S443_Falling_Edge_Debounce1 /end SUB_GROUP /begin REF_CHARACTERISTIC PwrMCU_tDbncKeyOff_val PwrMCU_tDbncKeyOn_val /end REF_CHARACTERISTIC /end GROUP
/begin GROUP S438_Shut_Down_MCU "PROJ_v0/ECU_POWER_CONTROL/General Power Control/Shut Down MCU" /begin REF_CHARACTERISTIC PwrMCU_tShutDownDelay_val PwrMCU_tWaitKeyOn_val /end REF_CHARACTERISTIC /begin REF_MEASUREMENT PwrMCU_flgKeyOff /end REF_MEASUREMENT /end GROUP
/begin GROUP S439_Get_wake_up_signal "PROJ_v0/ECU_POWER_CONTROL/Get wake-up signal/Get wake-up signal" /begin REF_MEASUREMENT PwrMCU_flgKeyOnRaw /end REF_MEASUREMENT /end GROUP
/begin GROUP S13_APP_FUN_MODEL "PROJ_v0/ASW1/APP/modelApp_fun/APP_FUN_MODEL" /begin SUB_GROUP S14_TMS_DRIVERS S14_TmsControlApp /end SUB_GROUP /begin REF_CHARACTERISTIC dbgMdlEna2App_val dbgMdlEna2Drvrs_val /end REF_CHARACTERISTIC /end GROUP
/begin GROUP S214_SEND_CAN_DEBUG_CAN_1A_ONLY1 "PROJ_v0/ASW1/CAN_RECV/Subsystem/SEND_CAN_DEBUG_CAN_1A_ONLY1" /begin REF_CHARACTERISTIC dbgMdlEnaDbgCANTx_To1A /end REF_CHARACTERISTIC /end GROUP
/begin GROUP S214_SEND_CAN_DEBUG_CAN_1A_ONLY3 "PROJ_v0/ASW1/CAN_RECV/Subsystem/SEND_CAN_DEBUG_CAN_1A_ONLY3" /begin REF_CHARACTERISTIC dbgMdlEnaDbgCANTx_To1A /end REF_CHARACTERISTIC /end GROUP
/begin GROUP S214_SEND_CAN_DEBUG_CAN_1A_ONLY4 "PROJ_v0/ASW1/CAN_RECV/Subsystem/SEND_CAN_DEBUG_CAN_1A_ONLY4" /begin REF_CHARACTERISTIC dbgMdlEnaDbgCANTx_To1A /end REF_CHARACTERISTIC /end GROUP
/begin GROUP S214_Subsystem "PROJ_v0/ASW1/CAN_RECV/Subsystem/Subsystem" /begin REF_MEASUREMENT rxCAN_RAW_TCU_VCU_AVL rxCAN_RAW_TCU_VCU_DATA /end REF_MEASUREMENT /end GROUP
/begin GROUP S214_Subsystem1 "PROJ_v0/ASW1/CAN_RECV/Subsystem/Subsystem1" /begin REF_MEASUREMENT rxCAN_RAW_AC1_AVL /end REF_MEASUREMENT /end GROUP
/begin GROUP S248_Subsystem1 "PROJ_v0/ASW1/CAN_SND/CAN_SEND/Subsystem1" /begin SUB_GROUP S249_SEND_CAN_DEBUG_CAN_1A_ONLY2 /end SUB_GROUP /begin REF_MEASUREMENT txCAN_RAW_IsMsgAvl_AC_Message /end REF_MEASUREMENT /end GROUP
/begin GROUP S248_Subsystem2 "PROJ_v0/ASW1/CAN_SND/CAN_SEND/Subsystem2"
 /begin SUB_GROUP S250_SEND_CAN_DEBUG S250_SEND_CAN_DEBUG1 S250_SEND_CAN_DEBUG2 S250_SEND_CAN_DEBUG3 S250_SEND_CAN_DEBUG4 /end SUB_GROUP
 /begin REF_MEASUREMENT txCAN_RAW_IsMsgAvl_TMS_ActrsCmd txCAN_RAW_IsMsgAvl_tms_test_info_1 /end REF_MEASUREMENT
/end GROUP
/begin GROUP S248_Subsystem3 "PROJ_v0/ASW1/CAN_SND/CAN_SEND/Subsystem3"
 /begin REF_MEASUREMENT txCAN_RAW_IsMsgAvl_TCU_VCU txCAN_RAW_IsMsgAvl_TCU_VCU_Faults /end REF_MEASUREMENT
/end GROUP
/begin GROUP S302_Diag "PROJ_v0/ASW1/DIAGNOSTICS/Function-Call Subsystem/Diag"
 /begin REF_MEASUREMENT DiagHSO_stHSO01 DiagHSO_stHSO02 DiagHSO_stHSO03 DiagHSO_stHSO04 DiagHSO_stLS01 DiagHSO_stLSO02 DiagHSO_stLSO03 DiagHSO_stLSO04 DiagHSO_stLSO05 /end REF_MEASUREMENT
/end GROUP
/begin GROUP S318_sensors_read "PROJ_v0/ASW1/INPUTS_RECV/SENSORS_INPUT_SIGS/sensors_read"
 /begin SUB_GROUP S319__Override_Probe S319__Override_Probe1 S319__Override_Probe2 /end SUB_GROUP
/end GROUP
/begin GROUP S326_RTX "PROJ_v0/ASW1/LIN/Subsystem1/RTX"
 /begin SUB_GROUP S327_LIN_Master_Schedule S327_Mst_Rx_Mod S327_TCU__EcmEcm_Lin1Fr03_34_0x22___4 S327_TCU__EcmEcm_Lin1Fr05_51_0x33___3_ S327_TCU__P1_VCU_WP_EDS2_Control_18_0x12___8_ S327_TCU__V3_XCU_BFPVCtrlCmd_4_0x4___8 S327_TCU__V4_XCU_BFPVCtrlCmd_8_0x8___8 /end SUB_GROUP
 /begin REF_MEASUREMENT LIN_BusIdel_Flg LIN_status /end REF_MEASUREMENT
/end GROUP
/begin GROUP S443_Falling_Edge_Debounce1 "PROJ_v0/ECU_POWER_CONTROL/General Power Control/Debounce KeyOn/Falling Edge Debounce1" /begin REF_MEASUREMENT PwrMCU_flgKeyOn /end REF_MEASUREMENT /end GROUP
/begin GROUP S14_TMS_DRIVERS "PROJ_v0/ASW1/APP/modelApp_fun/APP_FUN_MODEL/TMS_DRIVERS"
 /begin SUB_GROUP S16_AC_DRIVER S16_DEBUG_OUT_DRVR S16_FAN_DRIVER S16_SENSOR_PROC S16_SOLENOID_DRIVER S16_SnsrOvrdDebug S16_Subsystem S16_Subsystem1 S16_Subsystem_Reference S16_VALVE1 S16_VALVE2 /end SUB_GROUP
/end GROUP
/begin GROUP S14_TmsControlApp "PROJ_v0/ASW1/APP/modelApp_fun/APP_FUN_MODEL/TmsControlApp" /begin SUB_GROUP TcuApp0 /end SUB_GROUP /end GROUP
/begin GROUP S249_SEND_CAN_DEBUG_CAN_1A_ONLY2 "PROJ_v0/ASW1/CAN_SND/CAN_SEND/Subsystem1/SEND_CAN_DEBUG_CAN_1A_ONLY2" /begin REF_CHARACTERISTIC dbgMdlEnaDbgCANTx_To1A /end REF_CHARACTERISTIC /end GROUP
/begin GROUP S250_SEND_CAN_DEBUG "PROJ_v0/ASW1/CAN_SND/CAN_SEND/Subsystem2/SEND_CAN_DEBUG" /begin REF_CHARACTERISTIC dbgMdlEnaDbgCANTx_To1A dbgMdlEnaDbgCANTx_To3C /end REF_CHARACTERISTIC /end GROUP
/begin GROUP S250_SEND_CAN_DEBUG1 "PROJ_v0/ASW1/CAN_SND/CAN_SEND/Subsystem2/SEND_CAN_DEBUG1" /begin REF_CHARACTERISTIC dbgMdlEnaDbgCANTx_To1A dbgMdlEnaDbgCANTx_To3C /end REF_CHARACTERISTIC /end GROUP
/begin GROUP S250_SEND_CAN_DEBUG2 "PROJ_v0/ASW1/CAN_SND/CAN_SEND/Subsystem2/SEND_CAN_DEBUG2" /begin REF_CHARACTERISTIC dbgMdlEnaDbgCANTx_To1A dbgMdlEnaDbgCANTx_To3C /end REF_CHARACTERISTIC /end GROUP
/begin GROUP S250_SEND_CAN_DEBUG3 "PROJ_v0/ASW1/CAN_SND/CAN_SEND/Subsystem2/SEND_CAN_DEBUG3" /begin REF_CHARACTERISTIC dbgMdlEnaDbgCANTx_To1A dbgMdlEnaDbgCANTx_To3C /end REF_CHARACTERISTIC /end GROUP
/begin GROUP S250_SEND_CAN_DEBUG4 "PROJ_v0/ASW1/CAN_SND/CAN_SEND/Subsystem2/SEND_CAN_DEBUG4" /begin REF_CHARACTERISTIC dbgMdlEnaDbgCANTx_To1A dbgMdlEnaDbgCANTx_To3C /end REF_CHARACTERISTIC /end GROUP
/begin GROUP S319__Override_Probe "PROJ_v0/ASW1/INPUTS_RECV/SENSORS_INPUT_SIGS/sensors_read/ Override Probe" /begin REF_CHARACTERISTIC Test_AnInpVolt_A01OvrCal_val Test_AnInpVolt_A01OvrEn_val /end REF_CHARACTERISTIC /begin REF_MEASUREMENT Test_AnInpVolt_A01OvrMsr /end REF_MEASUREMENT /end GROUP
/begin GROUP S319__Override_Probe1 "PROJ_v0/ASW1/INPUTS_RECV/SENSORS_INPUT_SIGS/sensors_read/ Override Probe1" /begin REF_CHARACTERISTIC Test_AnInpVolt_A03OvrCal_val Test_AnInpVolt_A03OvrEn_val /end REF_CHARACTERISTIC /begin REF_MEASUREMENT Test_AnInpVolt_A03OvrMsr /end REF_MEASUREMENT /end GROUP
/begin GROUP S319__Override_Probe2 "PROJ_v0/ASW1/INPUTS_RECV/SENSORS_INPUT_SIGS/sensors_read/ Override Probe2" /begin REF_CHARACTERISTIC Test_AnInpVolt_A04OvrCal_val Test_AnInpVolt_A04OvrEn_val /end REF_CHARACTERISTIC /begin REF_MEASUREMENT Test_AnInpVolt_A04OvrMsr /end REF_MEASUREMENT /end GROUP
/begin GROUP S327_LIN_Master_Schedule "PROJ_v0/ASW1/LIN/Subsystem1/RTX/LIN Master Schedule" /begin REF_MEASUREMENT LIN_cntSchdler /end REF_MEASUREMENT /end GROUP
/begin GROUP S327_Mst_Rx_Mod "PROJ_v0/ASW1/LIN/Subsystem1/RTX/Mst Rx Mod"
 /begin SUB_GROUP S332_HVCH__HvchEcm_Lin1Fr01_39_0x27___7_ S332_HVCH__HvchEcm_Lin1Fr02_23_0x17___3_ S332_HVCH__HvchEcm_Lin1Fr03_52_0x34___3 S332_LIN_DATA2BUS_VALVE3W__V3_BFPV_StatusInfo_5_0x5___1 S332_LIN_DATA2BUS_VALVE3W__V3_BFPV_StatusInfo_5_0x5___8 S332_LIN_Receive_Data1 S332_LIN_Receive_Data2 S332_LIN_Receive_Data3 S332_LIN_Receive_Data4 S332_LIN_Receive_Data5 S332_LIN_Receive_Data6 S332_LinBus_MsgAvlToutCheck S332_LinBus_MsgAvlToutCheck1 S332_LinBus_MsgAvlToutCheck2 S332_PUMP1__P1_WP_EDS2_Status_17_0x11___8_ /end SUB_GROUP
 /begin REF_CHARACTERISTIC LIN_Id17_RxTout LIN_Id5_RxTout LIN_Id9_RxTout /end REF_CHARACTERISTIC
/end GROUP
/begin GROUP S327_TCU__EcmEcm_Lin1Fr03_34_0x22___4 "PROJ_v0/ASW1/LIN/Subsystem1/RTX/TCU: EcmEcm_Lin1Fr03 34 0x22 : 4" /begin SUB_GROUP S334_SEND_LIN2CAN_DEBUG /end SUB_GROUP /end GROUP
/begin GROUP S327_TCU__EcmEcm_Lin1Fr05_51_0x33___3_ "PROJ_v0/ASW1/LIN/Subsystem1/RTX/TCU: EcmEcm_Lin1Fr05 51 0x33 : 3 " /begin SUB_GROUP S335_SEND_LIN2CAN_DEBUG /end SUB_GROUP /end GROUP
/begin GROUP S327_TCU__P1_VCU_WP_EDS2_Control_18_0x12___8_ "PROJ_v0/ASW1/LIN/Subsystem1/RTX/TCU: P1_VCU_WP_EDS2_Control 18 0x12 : 8 " /begin SUB_GROUP S336_SEND_LIN2CAN_DEBUG /end SUB_GROUP /end GROUP
/begin GROUP S327_TCU__V3_XCU_BFPVCtrlCmd_4_0x4___8 "PROJ_v0/ASW1/LIN/Subsystem1/RTX/TCU: V3_XCU_BFPVCtrlCmd 4 0x4 : 8" /begin SUB_GROUP S337_SEND_LIN2CAN_DEBUG /end SUB_GROUP /end GROUP
/begin GROUP S327_TCU__V4_XCU_BFPVCtrlCmd_8_0x8___8 "PROJ_v0/ASW1/LIN/Subsystem1/RTX/TCU: V4_XCU_BFPVCtrlCmd 8 0x8 : 8" /begin SUB_GROUP S338_SEND_LIN2CAN_DEBUG /end SUB_GROUP /end GROUP
/begin GROUP S16_AC_DRIVER "PROJ_v0/ASW1/APP/modelApp_fun/APP_FUN_MODEL/TMS_DRIVERS/AC_DRIVER" /begin SUB_GROUP S18_Subsystem /end SUB_GROUP /end GROUP
/begin GROUP S16_DEBUG_OUT_DRVR "PROJ_v0/ASW1/APP/modelApp_fun/APP_FUN_MODEL/TMS_DRIVERS/DEBUG_OUT_DRVR"
 /begin REF_CHARACTERISTIC dbgMdlEnaCANTx_TMS_ActrsCmd dbgMdlEnaCANTx_TMS_ActrsDrvrInfo dbgMdlEnaCANTx_TMS_CTRL_INFO1 dbgMdlEnaCANTx_tms_test_info_1 dbgMdlEnaCANTx_tms_test_info_2 /end REF_CHARACTERISTIC
/end GROUP
/begin GROUP S16_FAN_DRIVER "PROJ_v0/ASW1/APP/modelApp_fun/APP_FUN_MODEL/TMS_DRIVERS/FAN_DRIVER"
 /begin SUB_GROUP S20__Override_Probe S20__Override_Probe1 S20__Override_Probe3 /end SUB_GROUP
 /begin REF_CHARACTERISTIC FanDrvrFanRdyChkFlt FanDrvrRunStMinSpdThd FanDrvrSpdCtlrErr FanDrvrSpdReqRateLim /end REF_CHARACTERISTIC
/end GROUP
/begin GROUP S16_SENSOR_PROC "PROJ_v0/ASW1/APP/modelApp_fun/APP_FUN_MODEL/TMS_DRIVERS/SENSOR_PROC"
 /begin SUB_GROUP S21_Subsystem_Reference S21_Subsystem_Reference1 S21_Subsystem_Reference2 /end SUB_GROUP
 /begin REF_CHARACTERISTIC SnsrPHi_FilTiCon SnsrPHi_PMapY SnsrPHi_PMinMax SnsrPHi_POfs SnsrPHi_VoltMapX SnsrPHi_VoltMinMax SnsrPLo_FilTiCon SnsrPLo_PMapY SnsrPLo_PMinMax SnsrPLo_POfs SnsrPLo_VoltMapX SnsrPLo_VoltMinMax SnsrTBattCoolt_FilTiCon SnsrTBattCoolt_RMapX SnsrTBattCoolt_Rext SnsrTBattCoolt_Rint SnsrTBattCoolt_SwtIntRes SnsrTBattCoolt_TDegMapY SnsrTBattCoolt_TDegMinMax SnsrTBattCoolt_TdegOfs SnsrTBattCoolt_VoltMinMax SnsrTBattCoolt_Vref /end REF_CHARACTERISTIC
/end GROUP
/begin GROUP S16_SOLENOID_DRIVER "PROJ_v0/ASW1/APP/modelApp_fun/APP_FUN_MODEL/TMS_DRIVERS/SOLENOID_DRIVER" /begin SUB_GROUP S22__Override_Probe S22__Override_Probe1 /end SUB_GROUP /begin REF_CHARACTERISTIC SolDrvrCmdTout /end REF_CHARACTERISTIC /end GROUP
/begin GROUP S16_SnsrOvrdDebug "PROJ_v0/ASW1/APP/modelApp_fun/APP_FUN_MODEL/TMS_DRIVERS/SnsrOvrdDebug"
 /begin SUB_GROUP S23_SnsrP_HiPSide_Volt S23_SnsrP_LoPSide_Volt S23_SnsrT_BattCoolt_Volt /end SUB_GROUP
/end GROUP
/begin GROUP S16_Subsystem "PROJ_v0/ASW1/APP/modelApp_fun/APP_FUN_MODEL/TMS_DRIVERS/Subsystem"
 /begin REF_MEASUREMENT rxLIN_PUMP_Eds2PmpStatCooltPmpErrSts rxLIN_PUMP_Eds2PmpStatCooltPmpSetSpdReq rxLIN_PUMP_Eds2PmpStatCooltPmpSpd rxLIN_PUMP_ErrRespBCPF /end REF_MEASUREMENT
/end GROUP
/begin GROUP S16_Subsystem_Reference "PROJ_v0/ASW1/APP/modelApp_fun/APP_FUN_MODEL/TMS_DRIVERS/Subsystem Reference" /begin SUB_GROUP S25__Override_Probe /end SUB_GROUP
 /begin REF_CHARACTERISTIC PmpDrvrMinSpdRunThd PmpDrvrSpdErrThd PmpDrvrSpdFbSrc PmpDrvrSpdMaxReq PmpDrvrSpdMinReq PmpDrvrSpdRateLim /end REF_CHARACTERISTIC
/end GROUP
/begin GROUP S16_Subsystem1 "PROJ_v0/ASW1/APP/modelApp_fun/APP_FUN_MODEL/TMS_DRIVERS/Subsystem1"
 /begin SUB_GROUP S26_CAN_TCU_VCU S26_CAN_TMS_CTRL_DRVR S26_CAN_VCU_TCU_DRVR S26_TCU_VCU_Faults /end SUB_GROUP
/end GROUP
/begin GROUP S16_VALVE1 "PROJ_v0/ASW1/APP/modelApp_fun/APP_FUN_MODEL/TMS_DRIVERS/VALVE1" /begin SUB_GROUP S27_VALVE1 /end SUB_GROUP
 /begin REF_CHARACTERISTIC Test_Actr_V1_EnableOvrCal_val Test_Actr_V1_MoveEnableOvrCal_val Test_Actr_V1_PosSetReqOvrCal_val Vlv1DrvrPosnCtrlErrThd /end REF_CHARACTERISTIC
/end GROUP
/begin GROUP S16_VALVE2 "PROJ_v0/ASW1/APP/modelApp_fun/APP_FUN_MODEL/TMS_DRIVERS/VALVE2" /begin SUB_GROUP S28_VALVE_CTRL /end SUB_GROUP
 /begin REF_CHARACTERISTIC Test_Actr_V2_EnableOvrCal_val Test_Actr_V2_MoveEnableOvrCal_val Test_Actr_V2_PosSetReqOvrCal_val Vlv2DrvrPosnCtrlErrThd /end REF_CHARACTERISTIC
/end GROUP
/begin GROUP S332_HVCH__HvchEcm_Lin1Fr01_39_0x27___7_ "PROJ_v0/ASW1/LIN/Subsystem1/RTX/Mst Rx Mod/HVCH: HvchEcm_Lin1Fr01 39 0x27 : 7 " /begin SUB_GROUP S345_SEND_LIN2CAN_DEBUG /end SUB_GROUP /end GROUP
/begin GROUP S332_HVCH__HvchEcm_Lin1Fr02_23_0x17___3_ "PROJ_v0/ASW1/LIN/Subsystem1/RTX/Mst Rx Mod/HVCH: HvchEcm_Lin1Fr02 23 0x17 : 3 " /begin SUB_GROUP S346_SEND_LIN2CAN_DEBUG /end SUB_GROUP /end GROUP
/begin GROUP S332_HVCH__HvchEcm_Lin1Fr03_52_0x34___3 "PROJ_v0/ASW1/LIN/Subsystem1/RTX/Mst Rx Mod/HVCH: HvchEcm_Lin1Fr03 52 0x34 : 3" /begin SUB_GROUP S347_SEND_LIN2CAN_DEBUG /end SUB_GROUP /end GROUP
/begin GROUP S332_LIN_Receive_Data1 "PROJ_v0/ASW1/LIN/Subsystem1/RTX/Mst Rx Mod/LIN Receive Data1" /begin REF_MEASUREMENT LIN_Id11_RxRes_WP_EDS2_Status_1 rxLIN_Id17_data /end REF_MEASUREMENT /end GROUP
/begin GROUP S332_LIN_Receive_Data2 "PROJ_v0/ASW1/LIN/Subsystem1/RTX/Mst Rx Mod/LIN Receive Data2" /begin REF_MEASUREMENT LIN_Id5_RxRes LIN_Id5_Rx_data /end REF_MEASUREMENT /end GROUP
/begin GROUP S332_LIN_Receive_Data3 "PROJ_v0/ASW1/LIN/Subsystem1/RTX/Mst Rx Mod/LIN Receive Data3" /begin REF_MEASUREMENT LIN_Id9_RxRes LIN_Id9_Rx_data /end REF_MEASUREMENT /end GROUP
/begin GROUP S332_LIN_Receive_Data4 "PROJ_v0/ASW1/LIN/Subsystem1/RTX/Mst Rx Mod/LIN Receive Data4" /begin REF_MEASUREMENT LIN_Id39_RxRes LIN_Id39_Rx_data /end REF_MEASUREMENT /end GROUP
/begin GROUP S332_LIN_Receive_Data5 "PROJ_v0/ASW1/LIN/Subsystem1/RTX/Mst Rx Mod/LIN Receive Data5" /begin REF_MEASUREMENT LIN_Id23_RxRes LIN_Id23_Rx_data /end REF_MEASUREMENT /end GROUP
/begin GROUP S332_LIN_Receive_Data6 "PROJ_v0/ASW1/LIN/Subsystem1/RTX/Mst Rx Mod/LIN Receive Data6" /begin REF_MEASUREMENT LIN_Id52_RxRes LIN_Id52_Rx_data /end REF_MEASUREMENT /end GROUP
/begin GROUP S332_LIN_DATA2BUS_VALVE3W__V3_BFPV_StatusInfo_5_0x5___1 "PROJ_v0/ASW1/LIN/Subsystem1/RTX/Mst Rx Mod/LIN_DATA2BUS_VALVE3W: V3_BFPV_StatusInfo 5 0x5 : 1" /begin SUB_GROUP S354_SEND_LIN2CAN_DEBUG /end SUB_GROUP /end GROUP
/begin GROUP S332_LIN_DATA2BUS_VALVE3W__V3_BFPV_StatusInfo_5_0x5___8 "PROJ_v0/ASW1/LIN/Subsystem1/RTX/Mst Rx Mod/LIN_DATA2BUS_VALVE3W: V3_BFPV_StatusInfo 5 0x5 : 8" /begin SUB_GROUP S355_SEND_LIN2CAN_DEBUG /end SUB_GROUP /end GROUP
/begin GROUP S332_LinBus_MsgAvlToutCheck "PROJ_v0/ASW1/LIN/Subsystem1/RTX/Mst Rx Mod/LinBus_MsgAvlToutCheck" /begin REF_MEASUREMENT LIN_Id17_Rx_dT /end REF_MEASUREMENT /end GROUP
/begin GROUP S332_LinBus_MsgAvlToutCheck1 "PROJ_v0/ASW1/LIN/Subsystem1/RTX/Mst Rx Mod/LinBus_MsgAvlToutCheck1" /begin REF_MEASUREMENT LIN_Id5_Rx_dT /end REF_MEASUREMENT /end GROUP
/begin GROUP S332_LinBus_MsgAvlToutCheck2 "PROJ_v0/ASW1/LIN/Subsystem1/RTX/Mst Rx Mod/LinBus_MsgAvlToutCheck2" /begin REF_MEASUREMENT LIN_Id9_Rx_dT /end REF_MEASUREMENT /end GROUP
/begin GROUP S332_PUMP1__P1_WP_EDS2_Status_17_0x11___8_ "PROJ_v0/ASW1/LIN/Subsystem1/RTX/Mst Rx Mod/PUMP1: P1_WP_EDS2_Status 17 0x11 : 8_" /begin SUB_GROUP S359_SEND_LIN2CAN_DEBUG /end SUB_GROUP /end GROUP
/begin GROUP S334_SEND_LIN2CAN_DEBUG "PROJ_v0/ASW1/LIN/Subsystem1/RTX/TCU: EcmEcm_Lin1Fr03 34 0x22 : 4/SEND_LIN2CAN_DEBUG" /begin REF_CHARACTERISTIC dbgMdlEnaDbgLIN2CAN /end REF_CHARACTERISTIC /end GROUP
/begin GROUP S335_SEND_LIN2CAN_DEBUG "PROJ_v0/ASW1/LIN/Subsystem1/RTX/TCU: EcmEcm_Lin1Fr05 51 0x33 : 3 /SEND_LIN2CAN_DEBUG" /begin REF_CHARACTERISTIC dbgMdlEnaDbgLIN2CAN /end REF_CHARACTERISTIC /end GROUP
/begin GROUP S336_SEND_LIN2CAN_DEBUG "PROJ_v0/ASW1/LIN/Subsystem1/RTX/TCU: P1_VCU_WP_EDS2_Control 18 0x12 : 8 /SEND_LIN2CAN_DEBUG" /begin REF_CHARACTERISTIC dbgMdlEnaDbgLIN2CAN /end REF_CHARACTERISTIC /end GROUP
/begin GROUP S337_SEND_LIN2CAN_DEBUG "PROJ_v0/ASW1/LIN/Subsystem1/RTX/TCU: V3_XCU_BFPVCtrlCmd 4 0x4 : 8/SEND_LIN2CAN_DEBUG" /begin REF_CHARACTERISTIC dbgMdlEnaDbgLIN2CAN /end REF_CHARACTERISTIC /end GROUP
/begin GROUP S338_SEND_LIN2CAN_DEBUG "PROJ_v0/ASW1/LIN/Subsystem1/RTX/TCU: V4_XCU_BFPVCtrlCmd 8 0x8 : 8/SEND_LIN2CAN_DEBUG" /begin REF_CHARACTERISTIC dbgMdlEnaDbgLIN2CAN /end REF_CHARACTERISTIC /end GROUP
/begin GROUP S18_Subsystem "PROJ_v0/ASW1/APP/modelApp_fun/APP_FUN_MODEL/TMS_DRIVERS/AC_DRIVER/Subsystem" /begin SUB_GROUP AcCmprDrvr_tcci_mdl /end SUB_GROUP
 /begin REF_MEASUREMENT Test_Actr_Ac_CAN_EnaCmdMsr Test_Actr_Ac_CAN_SpeedCmdMsr Test_Actr_Ac_DrvrSpdCmdSpMsr /end REF_MEASUREMENT
/end GROUP
/begin GROUP S20__Override_Probe "PROJ_v0/ASW1/APP/modelApp_fun/APP_FUN_MODEL/TMS_DRIVERS/FAN_DRIVER/ Override Probe" /begin REF_CHARACTERISTIC Test_Actr_FanSpdReqOvrCal_val Test_Actr_FanSpdReqOvrEn_val /end REF_CHARACTERISTIC /begin REF_MEASUREMENT Test_Actr_FanSpdReqOvrMsr /end REF_MEASUREMENT /end GROUP
/begin GROUP S20__Override_Probe1 "PROJ_v0/ASW1/APP/modelApp_fun/APP_FUN_MODEL/TMS_DRIVERS/FAN_DRIVER/ Override Probe1"
 /begin REF_CHARACTERISTIC Test_Actr_FanDrvrRdyOvrCal_val Test_Actr_FanDrvrRdyOvrEn_val /end REF_CHARACTERISTIC
 /begin REF_MEASUREMENT Test_Actr_FanDrvrRdyOvrMsr /end REF_MEASUREMENT
/end GROUP
/begin GROUP S20__Override_Probe3 "PROJ_v0/ASW1/APP/modelApp_fun/APP_FUN_MODEL/TMS_DRIVERS/FAN_DRIVER/ Override Probe3"
 /begin REF_CHARACTERISTIC Test_Actr_FanDrvrIsStOnOvrCal_val Test_Actr_FanDrvrIsStOnOvrEn_val /end REF_CHARACTERISTIC
 /begin REF_MEASUREMENT Test_Actr_FanDrvrIsStOnOvrMsr /end REF_MEASUREMENT
/end GROUP
/begin GROUP S21_Subsystem_Reference "PROJ_v0/ASW1/APP/modelApp_fun/APP_FUN_MODEL/TMS_DRIVERS/SENSOR_PROC/Subsystem Reference" /begin SUB_GROUP S52_FirstOrdFltB_1 /end SUB_GROUP /begin REF_MEASUREMENT SnrsP_HiP_FaultCode SnrsP_HiP_MeasdVal /end REF_MEASUREMENT /end GROUP
/begin GROUP S21_Subsystem_Reference1 "PROJ_v0/ASW1/APP/modelApp_fun/APP_FUN_MODEL/TMS_DRIVERS/SENSOR_PROC/Subsystem Reference1" /begin SUB_GROUP S53_FirstOrdFltB_1 /end SUB_GROUP /begin REF_MEASUREMENT SnrsP_LoP_FaultCode SnrsP_LoP_MeasdVal /end REF_MEASUREMENT /end GROUP
/begin GROUP S21_Subsystem_Reference2 "PROJ_v0/ASW1/APP/modelApp_fun/APP_FUN_MODEL/TMS_DRIVERS/SENSOR_PROC/Subsystem Reference2" /begin SUB_GROUP S54_FirstOrdFltB_1 /end SUB_GROUP /begin REF_MEASUREMENT SnsrT_BattCoolt_FaultCode SnsrT_BattCoolt_MeasdVal /end REF_MEASUREMENT /end GROUP
/begin GROUP S22__Override_Probe "PROJ_v0/ASW1/APP/modelApp_fun/APP_FUN_MODEL/TMS_DRIVERS/SOLENOID_DRIVER/ Override Probe" /begin REF_CHARACTERISTIC Test_Actr_Soln1CmdOvrCal_val Test_Actr_Soln1CmdOvrEn_val /end REF_CHARACTERISTIC /begin REF_MEASUREMENT Test_Actr_Soln1CmdOvrMsr /end REF_MEASUREMENT /end GROUP
/begin GROUP S22__Override_Probe1 "PROJ_v0/ASW1/APP/modelApp_fun/APP_FUN_MODEL/TMS_DRIVERS/SOLENOID_DRIVER/ Override Probe1" /begin REF_CHARACTERISTIC Test_Actr_Soln2CmdOvrCal_val Test_Actr_Soln2CmdOvrEn_val /end REF_CHARACTERISTIC /begin REF_MEASUREMENT Test_Actr_Soln2CmdOvrMsr /end REF_MEASUREMENT /end GROUP
/begin GROUP S23_SnsrP_HiPSide_Volt "PROJ_v0/ASW1/APP/modelApp_fun/APP_FUN_MODEL/TMS_DRIVERS/SnsrOvrdDebug/SnsrP_HiPSide_Volt" /begin SUB_GROUP S102__Override_Probe /end SUB_GROUP /end GROUP
/begin GROUP S23_SnsrP_LoPSide_Volt "PROJ_v0/ASW1/APP/modelApp_fun/APP_FUN_MODEL/TMS_DRIVERS/SnsrOvrdDebug/SnsrP_LoPSide_Volt" /begin SUB_GROUP S103__Override_Probe /end SUB_GROUP /end GROUP
/begin GROUP S23_SnsrT_BattCoolt_Volt "PROJ_v0/ASW1/APP/modelApp_fun/APP_FUN_MODEL/TMS_DRIVERS/SnsrOvrdDebug/SnsrT_BattCoolt_Volt" /begin SUB_GROUP S104__Override_Probe /end SUB_GROUP /end GROUP
/begin GROUP S25__Override_Probe "PROJ_v0/ASW1/APP/modelApp_fun/APP_FUN_MODEL/TMS_DRIVERS/Subsystem Reference/ Override Probe"
 /begin REF_CHARACTERISTIC Test_Actr_WP1_PmpSpdReqOvrCal_val Test_Actr_WP1_PmpSpdReqOvrEn_val /end REF_CHARACTERISTIC
 /begin REF_MEASUREMENT Test_Actr_WP1_PmpSpdReqOvrMsr /end REF_MEASUREMENT
/end GROUP
/begin GROUP S26_CAN_TCU_VCU "PROJ_v0/ASW1/APP/modelApp_fun/APP_FUN_MODEL/TMS_DRIVERS/Subsystem1/CAN_TCU_VCU" /begin REF_CHARACTERISTIC dbgMdlEnaCANTx_TCU_VCU /end REF_CHARACTERISTIC /end GROUP
/begin GROUP S26_CAN_TMS_CTRL_DRVR "PROJ_v0/ASW1/APP/modelApp_fun/APP_FUN_MODEL/TMS_DRIVERS/Subsystem1/CAN_TMS_CTRL_DRVR"
 /begin REF_MEASUREMENT rxCAN_test0_MsgAvl rxCAN_test0_PumpSpdOvrd_IsCmdOvrd rxCAN_test0_PumpSpdOvrd_cmd_prc rxCAN_test1_SnsrPres_HiP_Volt rxCAN_test1_SnsrPres_HiP_Volt_IsOvrd rxCAN_test2_MsgAvl /end REF_MEASUREMENT
/end GROUP
/begin GROUP S26_CAN_VCU_TCU_DRVR "PROJ_v0/ASW1/APP/modelApp_fun/APP_FUN_MODEL/TMS_DRIVERS/Subsystem1/CAN_VCU_TCU_DRVR"
 /begin REF_MEASUREMENT rxCAN_VCUTCU_BTMS_Enable rxCAN_VCUTCU_BatteryTargetTemp rxCAN_VCUTCU_ClimateModeReq rxCAN_VCUTCU_CondFanSpFb rxCAN_VCUTCU_CondFanStatus rxCAN_VCUTCU_IsMsgAvl /end REF_MEASUREMENT
/end GROUP
/begin GROUP S26_TCU_VCU_Faults "PROJ_v0/ASW1/APP/modelApp_fun/APP_FUN_MODEL/TMS_DRIVERS/Subsystem1/TCU_VCU_Faults" /begin REF_CHARACTERISTIC dbgMdlEnaCANTx_TCU_VCU_Faults /end REF_CHARACTERISTIC /end GROUP
/begin GROUP S27_VALVE1 "PROJ_v0/ASW1/APP/modelApp_fun/APP_FUN_MODEL/TMS_DRIVERS/VALVE1/VALVE1" /begin SUB_GROUP S173_Subsystem2 /end SUB_GROUP
 /begin REF_MEASUREMENT Test_Actr_V1_CmdMoveEnableOvrMsr Test_Actr_V1_Cmd_PosSetReqOvrMsr /end REF_MEASUREMENT
/end GROUP
/begin GROUP S28_VALVE_CTRL "PROJ_v0/ASW1/APP/modelApp_fun/APP_FUN_MODEL/TMS_DRIVERS/VALVE2/VALVE_CTRL" /begin SUB_GROUP S191_Subsystem2 /end SUB_GROUP
 /begin REF_MEASUREMENT Test_Actr_V2_CmdMoveEnableOvrMsr Test_Actr_V2_Cmd_PosSetReqOvrMsr /end REF_MEASUREMENT
/end GROUP
/begin GROUP S345_SEND_LIN2CAN_DEBUG "PROJ_v0/ASW1/LIN/Subsystem1/RTX/Mst Rx Mod/HVCH: HvchEcm_Lin1Fr01 39 0x27 : 7 /SEND_LIN2CAN_DEBUG" /begin REF_CHARACTERISTIC dbgMdlEnaDbgLIN2CAN /end REF_CHARACTERISTIC /end GROUP
/begin GROUP S346_SEND_LIN2CAN_DEBUG "PROJ_v0/ASW1/LIN/Subsystem1/RTX/Mst Rx Mod/HVCH: HvchEcm_Lin1Fr02 23 0x17 : 3 /SEND_LIN2CAN_DEBUG" /begin REF_CHARACTERISTIC dbgMdlEnaDbgLIN2CAN /end REF_CHARACTERISTIC /end GROUP
/begin GROUP S347_SEND_LIN2CAN_DEBUG "PROJ_v0/ASW1/LIN/Subsystem1/RTX/Mst Rx Mod/HVCH: HvchEcm_Lin1Fr03 52 0x34 : 3/SEND_LIN2CAN_DEBUG" /begin REF_CHARACTERISTIC dbgMdlEnaDbgLIN2CAN /end REF_CHARACTERISTIC /end GROUP
/begin GROUP S354_SEND_LIN2CAN_DEBUG "PROJ_v0/ASW1/LIN/Subsystem1/RTX/Mst Rx Mod/LIN_DATA2BUS_VALVE3W: V3_BFPV_StatusInfo 5 0x5 : 1/SEND_LIN2CAN_DEBUG" /begin REF_CHARACTERISTIC dbgMdlEnaDbgLIN2CAN /end REF_CHARACTERISTIC /end GROUP
/begin GROUP S355_SEND_LIN2CAN_DEBUG "PROJ_v0/ASW1/LIN/Subsystem1/RTX/Mst Rx Mod/LIN_DATA2BUS_VALVE3W: V3_BFPV_StatusInfo 5 0x5 : 8/SEND_LIN2CAN_DEBUG" /begin REF_CHARACTERISTIC dbgMdlEnaDbgLIN2CAN /end REF_CHARACTERISTIC /end GROUP
/begin GROUP S359_SEND_LIN2CAN_DEBUG "PROJ_v0/ASW1/LIN/Subsystem1/RTX/Mst Rx Mod/PUMP1: P1_WP_EDS2_Status 17 0x11 : 8_/SEND_LIN2CAN_DEBUG" /begin REF_CHARACTERISTIC dbgMdlEnaDbgLIN2CAN /end REF_CHARACTERISTIC /end GROUP
/begin GROUP S52_FirstOrdFltB_1 "PROJ_v0/ASW1/APP/modelApp_fun/APP_FUN_MODEL/TMS_DRIVERS/SENSOR_PROC/Subsystem Reference/FirstOrdFltB_1" /begin SUB_GROUP S66_filter_rst /end SUB_GROUP /end GROUP
/begin GROUP S53_FirstOrdFltB_1 "PROJ_v0/ASW1/APP/modelApp_fun/APP_FUN_MODEL/TMS_DRIVERS/SENSOR_PROC/Subsystem Reference1/FirstOrdFltB_1" /begin SUB_GROUP S75_filter_rst /end SUB_GROUP /end GROUP
/begin GROUP S54_FirstOrdFltB_1 "PROJ_v0/ASW1/APP/modelApp_fun/APP_FUN_MODEL/TMS_DRIVERS/SENSOR_PROC/Subsystem Reference2/FirstOrdFltB_1" /begin SUB_GROUP S84_filter_rst /end SUB_GROUP /end GROUP
/begin GROUP S102__Override_Probe "PROJ_v0/ASW1/APP/modelApp_fun/APP_FUN_MODEL/TMS_DRIVERS/SnsrOvrdDebug/SnsrP_HiPSide_Volt/ Override Probe"
 /begin REF_CHARACTERISTIC Test_SnsrP_HiPSide_VoltOvrCal_val Test_SnsrP_HiPSide_VoltOvrEn_val /end REF_CHARACTERISTIC
 /begin REF_MEASUREMENT Test_SnsrP_HiPSide_VoltOvrMsr /end REF_MEASUREMENT
/end GROUP
/begin GROUP S103__Override_Probe "PROJ_v0/ASW1/APP/modelApp_fun/APP_FUN_MODEL/TMS_DRIVERS/SnsrOvrdDebug/SnsrP_LoPSide_Volt/ Override Probe"
 /begin REF_CHARACTERISTIC Test_SnsrP_LoPSide_VoltOvrCal_val Test_SnsrP_LoPSide_VoltOvrEn_val /end REF_CHARACTERISTIC
 /begin REF_MEASUREMENT Test_SnsrP_LoPSide_VoltOvrMsr /end REF_MEASUREMENT
/end GROUP
/begin GROUP S104__Override_Probe "PROJ_v0/ASW1/APP/modelApp_fun/APP_FUN_MODEL/TMS_DRIVERS/SnsrOvrdDebug/SnsrT_BattCoolt_Volt/ Override Probe"
 /begin REF_CHARACTERISTIC Test_SnsrT_BattCoolt_VoltOvrCal_val Test_SnsrT_BattCoolt_VoltOvrEn_val /end REF_CHARACTERISTIC
 /begin REF_MEASUREMENT Test_SnsrT_BattCoolt_VoltOvrMsr /end REF_MEASUREMENT
/end GROUP
/begin GROUP S173_Subsystem2 "PROJ_v0/ASW1/APP/modelApp_fun/APP_FUN_MODEL/TMS_DRIVERS/VALVE1/VALVE1/Subsystem2"
 /begin REF_MEASUREMENT rxLIN_V1_BFPVMoveStatus rxLIN_V1_BFPVPosition rxLIN_V1_BFPVStatus rxLIN_V1_BFPVTempWarn rxLIN_V1_BFPVVoltageStatus rxLIN_V1_BFPV_ErrorResp /end REF_MEASUREMENT
/end GROUP
/begin GROUP S191_Subsystem2 "PROJ_v0/ASW1/APP/modelApp_fun/APP_FUN_MODEL/TMS_DRIVERS/VALVE2/VALVE_CTRL/Subsystem2"
 /begin REF_MEASUREMENT rxLIN_V2_BFPVMoveStatus rxLIN_V2_BFPVPosition rxLIN_V2_BFPVStatus rxLIN_V2_BFPVTempWarn rxLIN_V2_BFPVVoltageStatus rxLIN_V2_BFPV_ErrorResp /end REF_MEASUREMENT
/end GROUP
/begin GROUP S66_filter_rst "PROJ_v0/ASW1/APP/modelApp_fun/APP_FUN_MODEL/TMS_DRIVERS/SENSOR_PROC/Subsystem Reference/FirstOrdFltB_1/filter_rst" /begin REF_MEASUREMENT SnrsP_HiP_ElecBascFild /end REF_MEASUREMENT /end GROUP
/begin GROUP S75_filter_rst "PROJ_v0/ASW1/APP/modelApp_fun/APP_FUN_MODEL/TMS_DRIVERS/SENSOR_PROC/Subsystem Reference1/FirstOrdFltB_1/filter_rst" /begin REF_MEASUREMENT SnrsP_LoP_ElecBascFild /end REF_MEASUREMENT /end GROUP
/begin GROUP S84_filter_rst "PROJ_v0/ASW1/APP/modelApp_fun/APP_FUN_MODEL/TMS_DRIVERS/SENSOR_PROC/Subsystem Reference2/FirstOrdFltB_1/filter_rst" /begin REF_MEASUREMENT SnsrT_BattCoolt_ElecBascFild /end REF_MEASUREMENT /end GROUP
/begin GROUP AcCmprDrvr_tcci_mdl "AcCmprDrvr_tcci_mdl"
 /begin REF_CHARACTERISTIC AcCmprDrvrMinSpdRunThd AcCmprDrvrSpdMaxReq AcCmprDrvrSpdMinReq AcCmprDrvrSpdReqRateLim AcCmprDrvrTest_CmdEnaOvrd AcCmprDrvrTest_CmdSetSpdOvrd AcCmprDrvrTest_OvrdEnad /end REF_CHARACTERISTIC
/end GROUP
/begin GROUP TcuApp0 "TcuApp0"
 /begin REF_CHARACTERISTIC TmsBtmsAcCmdVect TmsBtmsFanCmdVect TmsBtmsIsEnad TmsBtmsModTHysThd1 TmsBtmsModTHysThd2 TmsBtmsModTLvl TmsBtmsPmpCmdVect TmsBtmsSol1CmdVect TmsBtmsSol2CmdVect TmsBtmsVlv1CmdVect TmsBtmsVlv2CmdVect TmsHvacAcHiP_OperLvl TmsHvacAcLoP_OperLvl TmsModHoldTmr TmsModInitTmr TmsModTranDebFilTmr TmsPmpMinRunTmr /end REF_CHARACTERISTIC
/end GROUP
/end MODULE
/end PROJECT
/* (add any file trailer comments here) */
/* EOF PROJ_v0.a2l */
